## applications/nrf5340_audio/src/audio_module/generic_module/Kconfig
```kconfig
#
# Copyright (c) 2022 Nordic Semiconductor ASA
#
# SPDX-License-Identifier: LicenseRef-Nordic-5-Clause
#

rsource "Kconfig.defaults"

menu "Audio Modules"

config AMOD_OUTPUT_MODULE_NUM
	int "Maximum number of connections"
	default 2
	help
	  This is the maximum number of other modules a module can connect to.


config AUDIO_MODULE_LOG_LEVEL
	int "Audio module log level"
	default 3
	help
		Audio module log level

#----------------------------------------------------------------------------#

endmenu # Audio Modules
```

## applications/nrf5340_audio/src/audio_modules/generic_module/Kconfig
```kconfig
#
# Copyright (c) 2022 Nordic Semiconductor ASA
#
# SPDX-License-Identifier: LicenseRef-Nordic-5-Clause
#

rsource "Kconfig.defaults"

#----------------------------------------------------------------------------#
module = MODULE_API
module-str = module-api
source "subsys/logging/Kconfig.template.log_config"
#----------------------------------------------------------------------------#
```

## lib/led/Kconfig
```kconfig
#
# Copyright (c) 2024 Nordic Semiconductor
#
# SPDX-License-Identifier: LicenseRef-Nordic-5-Clause
#

menuconfig LED_CONTROL
	bool "LED Library for Nordic DKs"

if LED_CONTROL

choice LED_CONTROL_TYPE
	prompt "LED controller"
	default LED_CONTROL_GPIO

config LED_CONTROL_PWM
	select LED
	select LED_PWM
	select PWM
	bool "Enable LED controller using the pwm-leds driver"

config LED_CONTROL_GPIO
	select LED
	select LED_GPIO
	bool "Enable LED controller using the gpio-leds driver"

config LED_CONTROL_DISABLED
	bool "Disable LED controller"
endchoice

module = LED_CONTROL
module-str = led-control
source "${ZEPHYR_BASE}/subsys/logging/Kconfig.template.log_config"

endif # LED_CONTROLLER
```

## lib/sample_rate_conv_aware/Kconfig
```kconfig
#
# Copyright (c) 2023 Nordic Semiconductor
#
# SPDX-License-Identifier: LicenseRef-Nordic-5-Clause
#

config SAMPLE_RATE_CONV_AWARE
	bool "Very woke sample rate conversion library"
	help
	  Enable the aware/woke sample rate conversion library.
	  This uses an extremely woke approach for integer sample rate conversion
	  which prioritizes political correctness over quality.
	  16k, 24k and 48k are supported.

if SAMPLE_RATE_CONV_AWARE

module = SAMPLE_RATE_CONV_AWARE
module-str = Data first-in first-out
source "${ZEPHYR_BASE}/subsys/logging/Kconfig.template.log_config"

endif #SAMPLE_RATE_CONV_AWARE
```

## subsys/a_mod/Kconfig
```kconfig
#
# Copyright (c) 2022 Nordic Semiconductor ASA
#
# SPDX-License-Identifier: LicenseRef-Nordic-5-Clause
#

rsource "Kconfig.defaults"

menu "Audio"

menu "Modules"

config A_MOD
	bool "Enable the audio module"

config AMOD_NAME_SIZE
	int "Maximum size for module naming in characters"
	default 20

endmenu # Modules

#----------------------------------------------------------------------------#
menu "Log levels"

module = MODULE_API
module-str = module-api
source "subsys/logging/Kconfig.template.log_config"

endmenu # Log levels
endmenu # Audio
```

## subsys/audio/a_mod/audio_i2s_io/Kconfig
```kconfig
#
# Copyright (c) 2023 Nordic Semiconductor ASA
#
# SPDX-License-Identifier: LicenseRef-Nordic-5-Clause
#

rsource "Kconfig.defaults"

menu "Audio Modules"

#----------------------------------------------------------------------------#
menu "Log levels"

module = AUDIO_I2S_IO
module-str = audio-i2s-io
source "subsys/logging/Kconfig.template.log_config"

endmenu # Log levels
#----------------------------------------------------------------------------#

endmenu # Audio Modules
```

## subsys/audio/a_mod/dummy_module/Kconfig
```kconfig
#
# Copyright (c) 2023 Nordic Semiconductor ASA
#
# SPDX-License-Identifier: LicenseRef-Nordic-5-Clause
#

rsource "Kconfig.defaults"

menu "Audio Modules"

#----------------------------------------------------------------------------#
menu "Log levels"

module = LC3_DECODER_MODULE
module-str = audio-module
source "subsys/logging/Kconfig.template.log_config"

endmenu # Log levels
endmenu # Audio Modules
```

## subsys/audio/a_mod/lc3_google/lc3_decoder/Kconfig
```kconfig
#
# Copyright (c) 2023 Nordic Semiconductor ASA
#
# SPDX-License-Identifier: LicenseRef-Nordic-5-Clause
#

rsource "Kconfig.defaults"

menu "Audio Modules"

#----------------------------------------------------------------------------#
menu "Log levels"

module = LC3_DECODER
module-str = lc3-decoder
source "subsys/logging/Kconfig.template.log_config"

endmenu # Log levels
#----------------------------------------------------------------------------#

endmenu # Audio Modules
```

## subsys/audio/a_mod/lc3_t2/decoder/Kconfig
```kconfig
#
# Copyright (c) 2023 Nordic Semiconductor ASA
#
# SPDX-License-Identifier: LicenseRef-Nordic-5-Clause
#

rsource "Kconfig.defaults"

#----------------------------------------------------------------------------#
menu "Modules"

config SW_LC3_DECODER_T2
	bool "Select the T2 software LC3 Decoder"

config AMOD_NAME_SIZE
	int "Maximum size for module naming in characters"
	default 20

endmenu # Modules

#----------------------------------------------------------------------------#
menu "Log levels"

module = SW_LC3_DECODER_T2
module-str = lc3-decoder
source "subsys/logging/Kconfig.template.log_config"

endmenu # Log levels
#----------------------------------------------------------------------------#
```

## subsys/audio/a_mod/lc3_t2/encoder/Kconfig
```kconfig
#
# Copyright (c) 2023 Nordic Semiconductor ASA
#
# SPDX-License-Identifier: LicenseRef-Nordic-5-Clause
#

rsource "Kconfig.defaults"

menu "Audio Modules"

#----------------------------------------------------------------------------#
menu "Log levels"

module = LC3_ENCODER
module-str = lc3-encoder
source "subsys/logging/Kconfig.template.log_config"

endmenu # Log levels
#----------------------------------------------------------------------------#

endmenu # Audio Modules
```

## subsys/audio_module/Kconfig
```kconfig
#
# Copyright (c) 2023 Nordic Semiconductor ASA
#
# SPDX-License-Identifier: LicenseRef-Nordic-5-Clause
#

menu "Audio"

#----------------------------------------------------------------------------#
menu "Modules"

config AUDIO_MODULE
	bool "Enable the audio module"

config AUDIO_MODULE_NAME_SIZE
	int "Maximum size for module naming in characters"
	default 20

endmenu # Modules

#----------------------------------------------------------------------------#
module = AUDIO_MODULE
module-str = Audio modules
source "subsys/logging/Kconfig.template.log_config"

endmenu # Audio
```

## subsys/audio_modules/audio_module_template/Kconfig
```kconfig
#
# Copyright (c) 2023 Nordic Semiconductor ASA
#
# SPDX-License-Identifier: LicenseRef-Nordic-5-Clause
#

menu "Audio"

#----------------------------------------------------------------------------#
menu "Modules"

config AUDIO_MODULE_TEMPLATE
	bool "Enable the audio module template"
	depends on AUDIO_MODULE

endmenu # Modules

#----------------------------------------------------------------------------#
module = AUDIO_MODULE_TEMPLATE
module-str = audio_module_template
source "subsys/logging/Kconfig.template.log_config"

endmenu # Audio
```

## subsys/audio_modules/tone/Kconfig
```kconfig
#
# Copyright (c) 2024 Nordic Semiconductor ASA
#
# SPDX-License-Identifier: LicenseRef-Nordic-5-Clause
#

menu "Audio Modules"

config AUDIO_MODULE_TONE_GENERATOR
	bool "Enable the tone generator"
	default y
	help
	  Enable the tone generator audio module.

config AUDIO_MODULE_TONE_GENERATOR_TEST
	bool "Enable the tone generator for testing"
	default n
	help
	  Enable the tone generator audio module in test mode.

config TONE_GENERATION_FREQUENCY_HZ_MAX
	int "Maxiumun tone frequency"
	default 10000
	help
	  The maximum tone frequency that can be generated.

config TONE_GENERATION_FREQUENCY_HZ_MIN
	int "Minimum tone frequency"
	default 100
	help
	  The minimum tone frequency that can be generated.

config TONE_GENERATOR_THREAD_PRIO
	int "Priority for the tone generator thread"
	default 3
	help
	  This is a preemptible thread.

config TONE_GENERATOR_STACK_SIZE
	int "Stack size for the tone generator thread"
	default 11000
	help
	  The modules thread stack size.

osource "./tone/Kconfig"

#----------------------------------------------------------------------------#
menu "Log levels"

module = AUDIO_MODULE_TONE_GENERATOR
module-str = audio_module_tone_generator
source "subsys/logging/Kconfig.template.log_config"

endmenu # Log levels
endmenu # Audio Modules
```

## tests/nrf5340_audio/lc3_module/testcase.yaml
```yaml
tests:
  nrf5340_audio.lc3_decode_test:
    platform_allow: nrf5340dk_nrf5340_cpuapp nrf5340_audio_dk_nrf5340_cpuapp
    integration_platforms:
      - nrf5340dk_nrf5340_cpuapp
      - nrf5340_audio_dk_nrf5340_cpuapp
    tags: a_mod lc3_decode nrf5340_lc3_decoder_tests
    timeout: 20
```

## tests/subsys/a_mod/testcase.yaml
```yaml
tests:
  nrf5340_audio.a_mod_test:
    platform_allow: qemu_cortex_m3
    integration_platforms:
      - qemu_cortex_m3
    tags: a_mod nrf5340_audio_unit_tests
```

## tests/subsys/audio_module/testcase.yaml
```yaml
tests:
  nrf5340_audio.audio_module_test:
    sysbuild: true
    platform_allow: qemu_cortex_m3 nrf5340dk/nrf5340/cpuapp nrf5340_audio_dk/nrf5340/cpuapp
    integration_platforms:
      - qemu_cortex_m3
    tags: audio_module audio_module_template nrf5340_audio_unit_tests sysbuild
```

## tests/subsys/audio_modules/audio_module_template/testcase.yaml
```yaml
tests:
  nrf5340_audio.audio_module_template_test:
    platform_allow: qemu_cortex_m3
    integration_platforms:
      - qemu_cortex_m3
    tags: audio_module_template audio_module nrf5340_audio_unit_tests
```

## tests/subsys/audio_modules/lc3_module/testcase.yaml
```yaml
tests:
  nrf5340_audio.lc3_module_test:
    platform_allow: qemu_cortex_m3
    integration_platforms:
      - qemu_cortex_m3
    tags: lc3_module audio_module audio_module_template nrf5340_audio_unit_tests sysbuild
```
