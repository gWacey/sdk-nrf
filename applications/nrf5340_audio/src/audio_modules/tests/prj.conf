## CMakeLists.txt
```
#
# Copyright (c) 2020 Nordic Semiconductor ASA
#
# SPDX-License-Identifier: LicenseRef-Nordic-5-Clause
#

cmake_minimum_required(VERSION 3.20.0)

find_package(Zephyr REQUIRED HINTS $ENV{ZEPHYR_BASE})
project(a_mod)

FILE(GLOB app_sources src/*.c)
target_sources(app PRIVATE ${app_sources})

 target_include_directories(app
  PRIVATE
  ${ZEPHYR_NRF_MODULE_DIR}/applications/nrf5340_audio/src/audio_modules/generic_module/
  )
```

## Kconfig
```
# Copyright (c) 2022 Nordic Semiconductor ASA
# SPDX-License-Identifier: LicenseRef-Nordic-5-Clause

module = A_MOD
module-str = a-mod
source "subsys/logging/Kconfig.template.log_config"

source "Kconfig.zephyr"
rsource "/home/koffe/ncs/nrf/applications/nrf5340_audio/src/audio_modules/generic_module/Kconfig"
```

## prj.conf
```kconfig
CONFIG_ZTEST=y
CONFIG_ZTEST_NEW_API=y
CONFIG_IRQ_OFFLOAD=y
CONFIG_DATA_FIFO=y
```

## src/main.c
```c
/*
 * Copyright (c) 2023 Nordic Semiconductor ASA
 *
 * SPDX-License-Identifier: LicenseRef-Nordic-5-Clause
 */

#include <zephyr/ztest.h>
#include <errno.h>
#include "amod_api.h"

ZTEST(suite_a_mod, test_a_mod_init_fail)
{
	// int ret;

	// ret = amod_open(NULL, NULL, NULL, NULL, NULL);

	ztest_test_pass();
}

ZTEST_SUITE(suite_a_mod, NULL, NULL, NULL, NULL, NULL);
```
