## CMakeLists.txt
```
# Copyright (c) 2023 Nordic Semiconductor ASA
# SPDX-License-Identifier: LicenseRef-Nordic-5-Clause

cmake_minimum_required(VERSION 3.20.0)

find_package(Zephyr REQUIRED HINTS $ENV{ZEPHYR_BASE})

project(cmsis_resampler)

target_sources(app PRIVATE src/main.c)
```

## prj.conf
```kconfig
CONFIG_CMSIS_DSP=y
CONFIG_CMSIS_DSP_FILTERING=y
CONFIG_TIMING_FUNCTIONS=y
CONFIG_CBPRINTF_FP_SUPPORT=y
```

## src/main.c
```c
#include <zephyr/kernel.h>
#include <dsp/filtering_functions.h>

#include <zephyr/timing/timing.h>

#include "nrfx_clock.h"
#include "white20ms_16b16khz_mono.h"

#define FILTER_TAP_NUM 180
#define BLOCK_SIZE     WHITE20MS_16B16KHZ_MONO_SIZE
#define STATE_SIZE     (FILTER_TAP_NUM / 3) + BLOCK_SIZE - 1

q15_t filter_taps[FILTER_TAP_NUM] = {
	93,    142,   154,   79,   -62,	 -199,	-250,  -192, -76,  8,	  3,	 -68,	-127, -111,
	-30,   41,    39,    -31,  -97,	 -89,	-10,   66,   65,   -14,	  -94,	 -92,	-4,   86,
	88,    -4,    -102,  -106, -6,	 104,	113,   6,    -116, -129,  -13,	 123,	142,  17,
	-134,  -160,  -25,   144,  177,	 32,	-156,  -199, -42,  169,	  223,	 53,	-184, -251,
	-66,   201,   284,   82,   -221, -323,	-102,  244,  370,  126,	  -272,	 -429,	-157, 308,
	504,   197,   -355,  -606, -253, 420,	751,   336,  -516, -977,  -469,	 679,	1379, 725,
	-1016, -2311, -1414, 2157, 6951, 10357, 10357, 6951, 2157, -1414, -2311, -1016, 725,  1379,
	679,   -469,  -977,  -516, 336,	 751,	420,   -253, -606, -355,  197,	 504,	308,  -157,
	-429,  -272,  126,   370,  244,	 -102,	-323,  -221, 82,   284,	  201,	 -66,	-251, -184,
	53,    223,   169,   -42,  -199, -156,	32,    177,  144,  -25,	  -160,	 -134,	17,   142,
	123,   -13,   -129,  -116, 6,	 113,	104,   -6,   -106, -102,  -4,	 88,	86,   -4,
	-92,   -94,   -14,   65,   66,	 -10,	-89,   -97,  -31,  39,	  41,	 -30,	-111, -127,
	-68,   3,     8,     -76,  -192, -250,	-199,  -62,  79,   154,	  142,	 93};

q15_t destination_buf[BLOCK_SIZE * 3];

arm_fir_interpolate_instance_q15 fir;

q15_t state_buf[STATE_SIZE];
static uint8_t L = 48000 / 16000;

static int hfclock_config_and_start(void)
{
	int ret;

	/* Use this to turn on 128 MHz clock for cpu_app */
	ret = nrfx_clock_divider_set(NRF_CLOCK_DOMAIN_HFCLK, NRF_CLOCK_HFCLK_DIV_1);

	ret -= NRFX_ERROR_BASE_NUM;
	if (ret) {
		return ret;
	}

	nrfx_clock_hfclk_start();
	while (!nrfx_clock_hfclk_is_running()) {
	}

	return 0;
}

int main(void)
{
	printk("Halla verden\n");

	arm_status err;

	timing_t start_time, end_time;
	uint64_t total_cycles;
	uint64_t total_ns;

	hfclock_config_and_start();
	timing_init();
	timing_start();

	/* Initialize FIR instance */
	err = arm_fir_interpolate_init_q15(&fir, L, FILTER_TAP_NUM, filter_taps, state_buf,
					   BLOCK_SIZE);
	if (err != ARM_MATH_SUCCESS) {
		printk("arm_fir_decimate_init_q15: %d\n", err);
		while (1) {
		};
	}

	start_time = timing_counter_get();

	arm_fir_interpolate_q15(&fir, test_data_in, destination_buf, BLOCK_SIZE);

	end_time = timing_counter_get();
	total_cycles = timing_cycles_get(&start_time, &end_time);
	total_ns = timing_cycles_to_ns(total_cycles);
	timing_stop();

	/*for (int i = 0; i < BLOCK_SIZE; i++) {
		printk("%d: %d\n", i, destination_buf[i]);
	}*/

	printk("Time used: %lf ms\n", total_ns / 1000000.0);

	printk("Finished decimating\n");
}
```

## src/pink20ms_16b16khz_mono.h
```c
/*
 * Copyright (c) 2023 Nordic Semiconductor ASA
 *
 * SPDX-License-Identifier:  LicenseRef-Nordic-5-Clause
 */

#ifndef _PINK20MS_16B16KHZ_MONO_H_
#define _PINK20MS_16B16KHZ_MONO_H_

#include <stdint.h>

#define PINK20MS_16B16KHZ_MONO_SIZE (273)

int16_t test_data_in[PINK20MS_16B16KHZ_MONO_SIZE] = {
	0x085C, 0xFE76, 0xF56A, 0xF389, 0xFA20, 0x0472, 0x0B08, 0x0961, 0x012E, 0xF919, 0xF79D,
	0xFE44, 0x08E1, 0x10E0, 0x12A0, 0x0FA5, 0x0D3F, 0x0FD4, 0x1791, 0x2065, 0x253E, 0x23CA,
	0x1DC4, 0x172E, 0x1347, 0x12BC, 0x13F9, 0x1557, 0x1618, 0x1691, 0x169F, 0x1555, 0x1184,
	0x0B5E, 0x050F, 0x01A7, 0x0317, 0x08A0, 0x0F9C, 0x155C, 0x193D, 0x1C87, 0x20C7, 0x25C1,
	0x2930, 0x2865, 0x22AE, 0x1A22, 0x1271, 0x0E1C, 0x0D09, 0x0CC1, 0x0AE0, 0x06EA, 0x0297,
	0x0016, 0x0041, 0x022C, 0x0443, 0x0639, 0x0922, 0x0E43, 0x152C, 0x1AFC, 0x1C15, 0x16C3,
	0x0CDA, 0x0324, 0xFE6E, 0x00C6, 0x088F, 0x120C, 0x19D6, 0x1EB9, 0x2151, 0x22E6, 0x2410,
	0x24DD, 0x2565, 0x266B, 0x2897, 0x2BBE, 0x2E2E, 0x2E0E, 0x2AA8, 0x25C1, 0x2251, 0x229C,
	0x262A, 0x2A29, 0x2B95, 0x29BD, 0x26F3, 0x2688, 0x29E7, 0x2ED4, 0x30CA, 0x2C3E, 0x21A4,
	0x1566, 0x0D15, 0x0BBB, 0x0FEF, 0x158D, 0x18AF, 0x18B3, 0x178A, 0x17B0, 0x1943, 0x19CA,
	0x1683, 0x0F00, 0x065F, 0x0148, 0x028B, 0x08E4, 0x0FB7, 0x1225, 0x0EA1, 0x078F, 0x01BE,
	0x00B3, 0x04D5, 0x0B95, 0x11D1, 0x1602, 0x18C7, 0x1B71, 0x1E7A, 0x20A4, 0x202D, 0x1C54,
	0x1642, 0x1075, 0x0D31, 0x0D2D, 0x0F81, 0x127A, 0x14BC, 0x15B3, 0x156A, 0x13E8, 0x1157,
	0x0DC7, 0x09C6, 0x05C4, 0x01F9, 0xFE3A, 0xFA6D, 0xF742, 0xF645, 0xF8CF, 0xFECA, 0x05A4,
	0x0984, 0x0758, 0xFF52, 0xF53C, 0xEEAE, 0xEF96, 0xF7F1, 0x039C, 0x0D13, 0x10B9, 0x0ED2,
	0x0AE0, 0x0920, 0x0BCF, 0x125B, 0x1A0D, 0x204A, 0x23AC, 0x247A, 0x23A2, 0x2213, 0x205D,
	0x1F34, 0x1F6D, 0x21F2, 0x26B5, 0x2C76, 0x311E, 0x32D1, 0x317C, 0x2EBB, 0x2D35, 0x2E98,
	0x3276, 0x365E, 0x375E, 0x342A, 0x2E09, 0x2827, 0x2584, 0x269F, 0x293B, 0x29A4, 0x25AF,
	0x1E79, 0x1822, 0x170B, 0x1CA0, 0x260B, 0x2DA6, 0x2EF1, 0x2969, 0x2124, 0x1B95, 0x1BBA,
	0x1FD2, 0x22F1, 0x210C, 0x1A59, 0x138A, 0x1220, 0x1809, 0x21A9, 0x2819, 0x262D, 0x1C27,
	0x0FBC, 0x07E5, 0x07FD, 0x0DD7, 0x13C1, 0x1542, 0x1243, 0x0E7E, 0x0E21, 0x121D, 0x1782,
	0x1A5B, 0x18D9, 0x1527, 0x1347, 0x15B4, 0x1B54, 0x205E, 0x21AE, 0x1F67, 0x1CCE, 0x1D6F,
	0x2219, 0x2824, 0x2B8F, 0x2A6E, 0x261E, 0x2220, 0x20B4, 0x20E7, 0x1F4E, 0x1914, 0x0ED8,
	0x04DD, 0x004A, 0x03B8, 0x0D45, 0x1839, 0x1FEE, 0x2304, 0x233C, 0x23F3, 0x2738, 0x2CDF,
	0x32E5, 0x3735, 0x3896, 0x36D3, 0x31EA, 0x29D8, 0x1EF6, 0x12A8, 0x076E,
};

#endif /* _PINK20MS_16B16KHZ_MONO_H_ */
```

## src/white20ms_16b16khz_mono.h
```c
/*
 * Copyright (c) 2023 Nordic Semiconductor ASA
 *
 * SPDX-License-Identifier:  LicenseRef-Nordic-5-Clause
 */

#ifndef _WHITE20MS_16B16KHZ_MONO_H_
#define _WHITE20MS_16B16KHZ_MONO_H_

#include <stdint.h>

#define WHITE20MS_16B16KHZ_MONO_SIZE (273)

int16_t test_data_in[WHITE20MS_16B16KHZ_MONO_SIZE] = {
	0xDE9A, 0xD3AE, 0xD2A9, 0xDF58, 0xFBE9, 0x25A3, 0x50FF, 0x6AA4, 0x604F, 0x2EB6, 0xE9E2,
	0xB675, 0xB49B, 0xE87F, 0x3317, 0x6287, 0x52DA, 0x0777, 0xAAED, 0x8000, 0x8001, 0xB244,
	0xEB9A, 0xFCF6, 0xE04C, 0xB530, 0xA667, 0xC6C7, 0x0285, 0x2E89, 0x2AE5, 0xFBEE, 0xC746,
	0xB73F, 0xDB12, 0x1C9D, 0x51EC, 0x5CA0, 0x3E81, 0x14DD, 0x00A7, 0x0DE4, 0x2DD8, 0x44D6,
	0x408F, 0x2436, 0x03D5, 0xF3D6, 0xFAC3, 0x0EEE, 0x1F73, 0x205E, 0x10AD, 0xF7F9, 0xDF42,
	0xCBBC, 0xBDDC, 0xB487, 0xAFCB, 0xB1E9, 0xBD58, 0xD248, 0xEC71, 0x0312, 0x0BBF, 0xFFA9,
	0xE13F, 0xBE1E, 0xAA0A, 0xB3B5, 0xD9AA, 0x07D0, 0x2188, 0x1447, 0xE5D9, 0xB3EE, 0xA22C,
	0xC2A5, 0x07C8, 0x4B7F, 0x66D1, 0x4ADB, 0x0A71, 0xCDC1, 0xB948, 0xD880, 0x193D, 0x5919,
	0x7A0A, 0x712D, 0x484D, 0x1431, 0xE7E4, 0xCC9C, 0xC0ED, 0xBDB9, 0xBC24, 0xBA20, 0xBA8C,
	0xC298, 0xD45A, 0xEB46, 0xFCA6, 0xFDC2, 0xEC56, 0xD2FE, 0xC503, 0xD1F5, 0xF9C3, 0x2A0A,
	0x48F4, 0x46DB, 0x29DF, 0x0A20, 0xFFFF, 0x1174, 0x2CEA, 0x35F3, 0x1B01, 0xE32A, 0xA95A,
	0x88FC, 0x8AC4, 0xA12D, 0xB663, 0xBFA6, 0xC5F3, 0xDC55, 0x0BCE, 0x46B2, 0x6E41, 0x68C9,
	0x369D, 0xF58F, 0xCE57, 0xD8F0, 0x0BC1, 0x4296, 0x5833, 0x40C4, 0x1179, 0xF0D2, 0xFA2E,
	0x29CA, 0x5E81, 0x709E, 0x4D4E, 0x0442, 0xBE2F, 0xA312, 0xC0FC, 0x0463, 0x453F, 0x60A5,
	0x4D0D, 0x1CEB, 0xEFAC, 0xDB8F, 0xE0BE, 0xED3A, 0xEDBE, 0xDEBF, 0xCFD9, 0xD737, 0xFE1F,
	0x353D, 0x5B95, 0x53F8, 0x1B29, 0xCE12, 0x99D1, 0x9F25, 0xDBDE, 0x2A3A, 0x57EF, 0x463B,
	0xFE04, 0xAAC8, 0x8000, 0x9407, 0xDC02, 0x2B27, 0x5564, 0x4945, 0x1896, 0xE836, 0xD596,
	0xE28A, 0xF75C, 0xF6F5, 0xD750, 0xAB12, 0x957B, 0xB07F, 0xF822, 0x49C3, 0x797A, 0x6E81,
	0x33DB, 0xF0B1, 0xCE87, 0xDDE7, 0x0D3F, 0x36B9, 0x3B82, 0x18C5, 0xE873, 0xCDD1, 0xDC79,
	0x0AD9, 0x3930, 0x473A, 0x28B7, 0xEC04, 0xAF0D, 0x8C16, 0x8B80, 0xA32D, 0xC15A, 0xDA37,
	0xEDD6, 0x03DD, 0x217E, 0x425C, 0x59A0, 0x5B4B, 0x45C6, 0x25A9, 0x0F6F, 0x1338, 0x3213,
	0x5C08, 0x78C8, 0x75D9, 0x51DF, 0x1D52, 0xF0CE, 0xDE0C, 0xE681, 0xFBB3, 0x0A93, 0x07B1,
	0xF5E7, 0xE1DB, 0xD7A6, 0xD9C2, 0xE03E, 0xDFA4, 0xD225, 0xBB88, 0xA65F, 0x9CDE, 0xA3D1,
	0xBA36, 0xDBFF, 0x03CE, 0x29EC, 0x42E4, 0x41DE, 0x2060, 0xE63F, 0xAAFE, 0x8BDC, 0x9B30,
	0xD3A8, 0x1936, 0x48D7, 0x4D29, 0x2AA1, 0xFAB4, 0xDA48, 0xD798, 0xEBDE,
};

#endif /* _WHITE20MS_16B16KHZ_MONO_H_ */
```
