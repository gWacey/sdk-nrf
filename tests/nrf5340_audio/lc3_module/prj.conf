## CMakeLists.txt
```
#
# Copyright (c) 2023 Nordic Semiconductor ASA
#
# SPDX-License-Identifier: LicenseRef-Nordic-5-Clause
#

cmake_minimum_required(VERSION 3.20.0)

find_package(Zephyr REQUIRED HINTS $ENV{ZEPHYR_BASE})
project("Audio module")

target_sources(app PRIVATE src/main.c src/fakes.c src/decoder_test.c)

target_include_directories(app PRIVATE ${ZEPHYR_NRF_MODULE_DIR}/include)

zephyr_library_include_directories(${ZEPHYR_NRF_MODULE_DIR}/subsys/a_mod)
zephyr_library_include_directories(${ZEPHYR_NRF_MODULE_DIR}/subsys/audio/a_mod/lc3_t2/decoder)
zephyr_library_include_directories(${ZEPHYR_NRF_MODULE_DIR}/../nrfxlib/lc3/codec/inc)
zephyr_library_include_directories(${ZEPHYR_NRF_MODULE_DIR}/../nrfxlib/lc3/platform/os/inc)
zephyr_library_include_directories(${ZEPHYR_NRF_MODULE_DIR}/../nrfxlib/lc3/platform/os/baremetal/inc)
```

## Kconfig
```
#
# Copyright (c) 2023 Nordic Semiconductor ASA
#
# SPDX-License-Identifier: LicenseRef-Nordic-5-Clause
#

#----------------------------------------------------------------------------#

choice AUDIO_FRAME_DURATION
	prompt "Select frame duration - 7.5 ms frame duration is not tested"
	default AUDIO_FRAME_DURATION_10_MS
	help
	  LC3 supports frame duration of 7.5 and 10 ms.
	  If USB is selected as audio source, we should
	  have a frame duration of 10 ms since USB sends 1ms at a time.

config AUDIO_FRAME_DURATION_7_5_MS
	bool "7.5 ms"

config AUDIO_FRAME_DURATION_10_MS
	bool "10 ms"
endchoice

config AUDIO_FRAME_DURATION_US
	int
	default 7500 if AUDIO_FRAME_DURATION_7_5_MS
	default 10000 if AUDIO_FRAME_DURATION_10_MS
	help
	  Audio frame duration in µs.

choice AUDIO_SAMPLE_RATE
	prompt "Audio sample rate"
	default AUDIO_SAMPLE_RATE_16000_HZ if BT_BAP_BROADCAST_16_2_1 || BT_BAP_BROADCAST_16_2_2 || BT_BAP_UNICAST_16_2_1
	default AUDIO_SAMPLE_RATE_24000_HZ if BT_BAP_BROADCAST_24_2_1 || BT_BAP_BROADCAST_24_2_2 || BT_BAP_UNICAST_24_2_1
	default AUDIO_SAMPLE_RATE_48000_HZ
	help
	  This will be selected based on the BAP settings.

config AUDIO_SAMPLE_RATE_16000_HZ
	bool "16 kHz"
	help
	  Sample rate of 16kHz is currently only valid for I2S/line-in.

config AUDIO_SAMPLE_RATE_24000_HZ
	bool "24 kHz"
	help
	  Sample rate of 24kHz is currently only valid for I2S/line-in.

config AUDIO_SAMPLE_RATE_48000_HZ
	bool "48 kHz"
	help
	  Sample rate of 48kHz is valid for both I2S/line-in and USB.
endchoice

config AUDIO_SAMPLE_RATE_HZ
	int
	default 16000 if AUDIO_SAMPLE_RATE_16000_HZ
	default 24000 if AUDIO_SAMPLE_RATE_24000_HZ
	default 48000 if AUDIO_SAMPLE_RATE_48000_HZ
	help
	  I2S supports 16, 24, and 48 kHz sample rates for both input and output.
	  USB supports only 48 kHz for input.

choice AUDIO_BIT_DEPTH
	prompt "Audio bit depth"
	default AUDIO_BIT_DEPTH_16
	help
	  Select the bit depth for audio.

config AUDIO_BIT_DEPTH_16
	bool "16 bit audio"

config AUDIO_BIT_DEPTH_32
	bool "32 bit audio"
endchoice

config AUDIO_BIT_DEPTH_BITS
	int
	default 16 if AUDIO_BIT_DEPTH_16
	default 32 if AUDIO_BIT_DEPTH_32
	help
	  Bit depth of one sample in storage.

config AUDIO_BIT_DEPTH_OCTETS
	int
	default 2 if AUDIO_BIT_DEPTH_16
	default 4 if AUDIO_BIT_DEPTH_32
	help
	  Bit depth of one sample in storage given in octets.

#----------------------------------------------------------------------------#
config SW_LC3_DECODER_T2
	bool "Select the T2 software LC3 Decoder"

config AMOD_NAME_SIZE
	int "Maximum size for module naming in characters"
	default 20

#----------------------------------------------------------------------------#
menu "Log levels"

module = SW_LC3_DECODER_T2
module-str = lc3-decoder
source "subsys/logging/Kconfig.template.log_config"

endmenu # Log levels
#----------------------------------------------------------------------------#

source "Kconfig.zephyr"
```

## prj.conf
```kconfig
CONFIG_ZTEST=y
CONFIG_ZTEST_NEW_API=y
CONFIG_IRQ_OFFLOAD=y
CONFIG_DATA_FIFO=y
CONFIG_FPU=y
CONFIG_NEWLIB_LIBC=y
CONFIG_CMSIS_DSP=y
CONFIG_CMSIS_DSP_FASTMATH=y
CONFIG_CMSIS_DSP_TABLES=y
CONFIG_SW_CODEC_LC3_T2_SOFTWARE=y
CONFIG_DATA_FIFO=y
CONFIG_SW_LC3_DECODER_T2=y
CONFIG_A_MOD=y

CONFIG_NCS_INCLUDE_RPMSG_CHILD_IMAGE=n
CONFIG_BT=n
```

## src/main.c
```c
/*
 * Copyright (c) 2023 Nordic Semiconductor ASA
 *
 * SPDX-License-Identifier: LicenseRef-Nordic-5-Clause
 */

#include <zephyr/ztest.h>

ZTEST_SUITE(suite_lc3_decoder, NULL, NULL, NULL, NULL, NULL);
```

## src/common.h
```c
/*
 * Copyright (c) 2023 Nordic Semiconductor ASA
 *
 * SPDX-License-Identifier: LicenseRef-Nordic-5-Clause
 */

#ifndef _COMMON_H_
#define _COMMON_H_

#include "amod_api.h"

#define TEST_SAMPLE_BIT_DEPTH	    16
#define TEST_PCM_BIT_DEPTH	    16
#define TEST_ENC_MONO_BUF_SIZE	    120
#define TEST_ENC_STEREO_BUF_SIZE    (TEST_ENC_MONO_BUF_SIZE * 2)
#define TEST_DEC_MONO_BUF_SIZE	    960
#define TEST_DEC_MONO_BUF_SAMPLES   (TEST_DEC_MONO_BUF_SIZE / (TEST_PCM_BIT_DEPTH / 8))
#define TEST_DEC_STEREO_BUF_SIZE    (TEST_DEC_MONO_BUF_SIZE * 2)
#define TEST_DEC_STEREO_BUF_SAMPLES (TEST_DEC_STEREO_BUF_SIZE / (TEST_PCM_BIT_DEPTH / 8))
#define TEST_PCM_SAMPLE_RATE	    48000
#define TEST_LC3_BITRATE	    96000
#define TEST_LC3_FRAME_SIZE_US	    10000
#define TEST_LC3_NUM_CHANNELS	    2
#define TEST_AUDIO_CH_L		    0
#define TEST_AUDIO_CH_R		    1

#endif /* _COMMON_H_ */
```

## src/fakes.c
```c
/*
 * Copyright (c) 2022 Nordic Semiconductor ASA
 *
 * SPDX-License-Identifier: LicenseRef-Nordic-5-Clause
 */

#include <zephyr/fff.h>
#include <zephyr/ztest.h>
#include <errno.h>
#include <stdint.h>

#include "LC3API.h"
#include "fakes.h"
#include "common.h"

#include <zephyr/logging/log.h>
LOG_MODULE_REGISTER(module_fakes, 4);

#define TEST_ENC_SESSIONS_NUM (5)
#define TEST_DEC_SESSIONS_NUM (10)

struct lc3_dec_session {
	bool session_init;
	uint8_t *data_in;
};

uint8_t *wav_out;
int test_dec_out_size;

static int enc_count;
static int dec_count;
static LC3DecoderHandle_t enc_session[TEST_ENC_SESSIONS_NUM];

struct lc3_dec_session dec_session_ctx[TEST_DEC_SESSIONS_NUM];

/*
 * Stubs are defined here, so that multiple .C files can share them
 * without having linker issues.
 */
DEFINE_FFF_GLOBALS;

DEFINE_FAKE_VALUE_FUNC(int32_t OSALCALL, LC3Initialize, uint8_t, uint8_t, LC3FrameSizeConfig_t,
		       uint8_t, uint8_t *, uint32_t *);
DEFINE_FAKE_VALUE_FUNC(int32_t OSALCALL, LC3Deinitialize);
DEFINE_FAKE_VALUE_FUNC(LC3EncoderHandle_t OSALCALL, LC3EncodeSessionOpen, uint16_t, uint8_t,
		       LC3FrameSize_t, uint8_t *, uint16_t *, int32_t *);
DEFINE_FAKE_VALUE_FUNC(int32_t OSALCALL, LC3EncodeSessionData, LC3EncoderHandle_t,
		       LC3EncodeInput_t *, LC3EncodeOutput_t *);
DEFINE_FAKE_VOID_FUNC1(LC3EncodeSessionClose, LC3EncoderHandle_t);
DEFINE_FAKE_VALUE_FUNC(LC3DecoderHandle_t, LC3DecodeSessionOpen, uint16_t, uint8_t, LC3FrameSize_t,
		       uint8_t *, uint16_t *, int32_t *);
DEFINE_FAKE_VALUE_FUNC(int32_t, LC3DecodeSessionData, LC3DecoderHandle_t, LC3DecodeInput_t *,
		       LC3DecodeOutput_t *);
DEFINE_FAKE_VOID_FUNC1(LC3DecodeSessionClose, LC3DecoderHandle_t);
DEFINE_FAKE_VALUE_FUNC(uint16_t, LC3BitstreamBuffersize, uint16_t, uint32_t, LC3FrameSize_t,
		       int32_t *);
DEFINE_FAKE_VALUE_FUNC(uint16_t, LC3PCMBuffersize, uint16_t, uint8_t, LC3FrameSize_t, int32_t *);

/* Custom fakes implementation */
int32_t fake_LC3Initialize__succeeds(uint8_t encoderSampleRates, uint8_t decoderSampleRates,
				     LC3FrameSizeConfig_t frameSizeConfig, uint8_t uniqueSessions,
				     uint8_t *buffer, uint32_t *bufferSize)
{
	ARG_UNUSED(encoderSampleRates);
	ARG_UNUSED(decoderSampleRates);
	ARG_UNUSED(frameSizeConfig);
	ARG_UNUSED(uniqueSessions);
	ARG_UNUSED(buffer);
	ARG_UNUSED(bufferSize);

	enc_count = 0;
	dec_count = 0;

	for (int i = 0; i < TEST_DEC_SESSIONS_NUM; i++) {
		dec_session_ctx[i].session_init = false;
		dec_session_ctx[i].data_in = NULL;
	}

	return 0;
}

/* Custom fakes implementation */
int32_t fake_LC3Initialize__fails(uint8_t encoderSampleRates, uint8_t decoderSampleRates,
				  LC3FrameSizeConfig_t frameSizeConfig, uint8_t uniqueSessions,
				  uint8_t *buffer, uint32_t *bufferSize)
{
	ARG_UNUSED(encoderSampleRates);
	ARG_UNUSED(decoderSampleRates);
	ARG_UNUSED(frameSizeConfig);
	ARG_UNUSED(uniqueSessions);
	ARG_UNUSED(buffer);
	ARG_UNUSED(bufferSize);

	return -1;
}

/* Custom fakes implementation */
int32_t fake_LC3Deinitialize__succeeds(void)
{
	enc_count = 0;
	dec_count = 0;

	for (int i = 0; i < TEST_DEC_SESSIONS_NUM; i++) {
		dec_session_ctx[i].session_init = false;
		dec_session_ctx[i].data_in = NULL;
	}

	return 0;
}

/* Custom fakes implementation */
int32_t fake_LC3Deinitialize__fails(void)
{
	return -1;
}

/* Custom fakes implementation */
LC3EncoderHandle_t fake_LC3EncodeSessionOpen__succeeds(uint16_t sampleRate, uint8_t bitsPerSample,
						       LC3FrameSize_t frameSize, uint8_t *buffer,
						       uint16_t *bufferSize, int32_t *result)
{
	ARG_UNUSED(sampleRate);
	ARG_UNUSED(bitsPerSample);
	ARG_UNUSED(frameSize);
	ARG_UNUSED(buffer);
	ARG_UNUSED(bufferSize);
	ARG_UNUSED(result);

	return &enc_session[enc_count++];
}

/* Custom fakes implementation */
LC3EncoderHandle_t fake_LC3EncodeSessionOpen__fails(uint16_t sampleRate, uint8_t bitsPerSample,
						    LC3FrameSize_t frameSize, uint8_t *buffer,
						    uint16_t *bufferSize, int32_t *result)
{
	ARG_UNUSED(sampleRate);
	ARG_UNUSED(bitsPerSample);
	ARG_UNUSED(frameSize);
	ARG_UNUSED(buffer);
	ARG_UNUSED(bufferSize);
	ARG_UNUSED(result);

	return NULL;
}

int32_t fake_LC3EncodeSessionData__succeeds(LC3EncoderHandle_t encodeHandle,
					    LC3EncodeInput_t *encodeInput,
					    LC3EncodeOutput_t *encodeOutput)
{
	ARG_UNUSED(encodeHandle);
	ARG_UNUSED(encodeInput);
	ARG_UNUSED(encodeOutput);

	return 0;
}

int32_t fake_LC3EncodeSessionData__fails(LC3EncoderHandle_t encodeHandle,
					 LC3EncodeInput_t *encodeInput,
					 LC3EncodeOutput_t *encodeOutput)
{
	ARG_UNUSED(encodeHandle);
	ARG_UNUSED(encodeInput);
	ARG_UNUSED(encodeOutput);

	return -1;
}

void fake_LC3EncodeSessionClose__succeeds(LC3EncoderHandle_t encodeHandle)
{
	ARG_UNUSED(encodeHandle);
}

void fake_LC3EncodeSessionClose__fails(LC3EncoderHandle_t encodeHandle)
{
	ARG_UNUSED(encodeHandle);
}

LC3DecoderHandle_t fake_LC3DecodeSessionOpen__succeeds(uint16_t sampleRate, uint8_t bitsPerSample,
						       LC3FrameSize_t frameSize, uint8_t *buffer,
						       uint16_t *bufferSize, int32_t *result)
{
	ARG_UNUSED(sampleRate);
	ARG_UNUSED(bitsPerSample);
	ARG_UNUSED(frameSize);
	ARG_UNUSED(buffer);
	ARG_UNUSED(bufferSize);
	struct lc3_dec_session *session = (struct lc3_dec_session *)&dec_session_ctx[dec_count];

	session->session_init = true;
	session->data_in = wav_out;

	dec_count++;

	*result = 0;

	return (void *)session;
}

LC3DecoderHandle_t fake_LC3DecodeSessionOpen__fails(uint16_t sampleRate, uint8_t bitsPerSample,
						    LC3FrameSize_t frameSize, uint8_t *buffer,
						    uint16_t *bufferSize, int32_t *result)
{
	ARG_UNUSED(sampleRate);
	ARG_UNUSED(bitsPerSample);
	ARG_UNUSED(frameSize);
	ARG_UNUSED(buffer);
	ARG_UNUSED(bufferSize);

	*result = -1;

	return NULL;
}

int32_t fake_LC3DecodeSessionData__succeeds(LC3DecoderHandle_t decodeHandle,
					    LC3DecodeInput_t *decodeInput,
					    LC3DecodeOutput_t *decodeOutput)
{
	ARG_UNUSED(decodeInput);
	struct lc3_dec_session *session = (struct lc3_dec_session *)decodeHandle;
	uint8_t *data_out = (uint8_t *)decodeOutput->PCMData;
	uint8_t *data_in = session->data_in;

	for (int i = 0; i < test_dec_out_size; i++) {
		*data_out++ = *data_in++;
	}

	session->data_in += TEST_DEC_MONO_BUF_SIZE;

	decodeOutput->bytesWritten = TEST_DEC_MONO_BUF_SIZE;

	return 0;
}

int32_t fake_LC3DecodeSessionData__fails(LC3DecoderHandle_t decodeHandle,
					 LC3DecodeInput_t *decodeInput,
					 LC3DecodeOutput_t *decodeOutput)
{
	ARG_UNUSED(decodeHandle);
	ARG_UNUSED(decodeInput);
	ARG_UNUSED(decodeOutput);

	return -1;
}

void fake_LC3DecodeSessionClose__succeeds(LC3DecoderHandle_t decodeHandle)
{
	struct lc3_dec_session *session = (struct lc3_dec_session *)decodeHandle;

	session->session_init = false;
	session->data_in = NULL;
}

void fake_LC3DecodeSessionClose__fails(LC3DecoderHandle_t decodeHandle)
{
	ARG_UNUSED(decodeHandle);
}

uint16_t fake_LC3BitstreamBuffersize__succeeds(uint16_t sampleRate, uint32_t maxBitRate,
					       LC3FrameSize_t frameSize, int32_t *result)
{
	ARG_UNUSED(sampleRate);
	ARG_UNUSED(maxBitRate);
	ARG_UNUSED(frameSize);
	ARG_UNUSED(result);

	return TEST_ENC_MONO_BUF_SIZE;
}

uint16_t fake_LC3BitstreamBuffersize__fails(uint16_t sampleRate, uint32_t maxBitRate,
					    LC3FrameSize_t frameSize, int32_t *result)
{
	ARG_UNUSED(sampleRate);
	ARG_UNUSED(maxBitRate);
	ARG_UNUSED(frameSize);
	ARG_UNUSED(result);

	return 0;
}

uint16_t fake_LC3PCMBuffersize__succeeds(uint16_t sampleRate, uint8_t bitDepth,
					 LC3FrameSize_t frameSize, int32_t *result)
{
	ARG_UNUSED(sampleRate);
	ARG_UNUSED(bitDepth);
	ARG_UNUSED(frameSize);
	ARG_UNUSED(result);

	return 0;
}

uint16_t fake_LC3PCMBuffersize__fails(uint16_t sampleRate, uint8_t bitDepth,
				      LC3FrameSize_t frameSize, int32_t *result)
{
	ARG_UNUSED(sampleRate);
	ARG_UNUSED(bitDepth);
	ARG_UNUSED(frameSize);
	ARG_UNUSED(result);

	return -1;
}
```

## src/fakes.h
```c
/*
 * Copyright (c) 2022 Nordic Semiconductor ASA
 *
 * SPDX-License-Identifier: LicenseRef-Nordic-5-Clause
 */

#ifndef _FAKES_H_
#define _FAKES_H_

#include <zephyr/fff.h>
#include <zephyr/ztest.h>
#include <errno.h>
#include <stdint.h>

#include "LC3API.h"

/* Fake functions declaration */
DECLARE_FAKE_VALUE_FUNC(int32_t, LC3Initialize, uint8_t, uint8_t, LC3FrameSizeConfig_t, uint8_t,
			uint8_t *, uint32_t *);
DECLARE_FAKE_VALUE_FUNC(int32_t OSALCALL, LC3Deinitialize);
DECLARE_FAKE_VALUE_FUNC(LC3EncoderHandle_t OSALCALL, LC3EncodeSessionOpen, uint16_t, uint8_t,
			LC3FrameSize_t, uint8_t *, uint16_t *, int32_t *);
DECLARE_FAKE_VALUE_FUNC(int32_t, LC3EncodeSessionData, LC3EncoderHandle_t, LC3EncodeInput_t *,
			LC3EncodeOutput_t *);
DECLARE_FAKE_VOID_FUNC1(LC3EncodeSessionClose, LC3EncoderHandle_t);
DECLARE_FAKE_VALUE_FUNC(LC3DecoderHandle_t, LC3DecodeSessionOpen, uint16_t, uint8_t, LC3FrameSize_t,
			uint8_t *, uint16_t *, int32_t *);
DECLARE_FAKE_VALUE_FUNC(int32_t, LC3DecodeSessionData, LC3DecoderHandle_t, LC3DecodeInput_t *,
			LC3DecodeOutput_t *);
DECLARE_FAKE_VOID_FUNC1(LC3DecodeSessionClose, LC3DecoderHandle_t);
DECLARE_FAKE_VALUE_FUNC(uint16_t, LC3BitstreamBuffersize, uint16_t, uint32_t, LC3FrameSize_t,
			int32_t *);
DECLARE_FAKE_VALUE_FUNC(uint16_t, LC3PCMBuffersize, uint16_t, uint8_t, LC3FrameSize_t, int32_t *);

/* List of fakes used by this unit tester */
#define DO_FOREACH_FAKE(FUNC)                                                                      \
	do {                                                                                       \
		FUNC(LC3Initialize)                                                                \
		FUNC(LC3Deinitialize)                                                              \
		FUNC(LC3EncodeSessionOpen)                                                         \
		FUNC(LC3EncodeSessionData)                                                         \
		FUNC(LC3EncodeSessionClose)                                                        \
		FUNC(LC3DecodeSessionOpen)                                                         \
		FUNC(LC3DecodeSessionData)                                                         \
		FUNC(LC3DecodeSessionClose)                                                        \
		FUNC(LC3BitstreamBuffersize)                                                       \
		FUNC(LC3PCMBuffersize)                                                             \
	} while (0)

int32_t fake_LC3Initialize__succeeds(uint8_t encoderSampleRates, uint8_t decoderSampleRates,
				     LC3FrameSizeConfig_t frameSizeConfig, uint8_t uniqueSessions,
				     uint8_t *buffer, uint32_t *bufferSize);
int32_t fake_LC3Initialize__fails(uint8_t encoderSampleRates, uint8_t decoderSampleRates,
				  LC3FrameSizeConfig_t frameSizeConfig, uint8_t uniqueSessions,
				  uint8_t *buffer, uint32_t *bufferSize);
int32_t fake_LC3Deinitialize__succeeds(void);
int32_t fake_LC3Deinitialize__fails(void);
LC3EncoderHandle_t fake_LC3EncodeSessionOpen__succeeds(uint16_t sampleRate, uint8_t bitsPerSample,
						       LC3FrameSize_t frameSize, uint8_t *buffer,
						       uint16_t *bufferSize, int32_t *result);
LC3EncoderHandle_t fake_LC3EncodeSessionOpen__fails(uint16_t sampleRate, uint8_t bitsPerSample,
						    LC3FrameSize_t frameSize, uint8_t *buffer,
						    uint16_t *bufferSize, int32_t *result);
int32_t fake_LC3EncodeSessionData__succeeds(LC3EncoderHandle_t encodeHandle,
					    LC3EncodeInput_t *encodeInput,
					    LC3EncodeOutput_t *encodeOutput);
int32_t fake_LC3EncodeSessionData__fails(LC3EncoderHandle_t encodeHandle,
					 LC3EncodeInput_t *encodeInput,
					 LC3EncodeOutput_t *encodeOutput);
void fake_LC3EncodeSessionClose__succeeds(LC3EncoderHandle_t encodeHandle);
void fake_LC3EncodeSessionClose__fails(LC3EncoderHandle_t encodeHandle);
LC3DecoderHandle_t fake_LC3DecodeSessionOpen__succeeds(uint16_t sampleRate, uint8_t bitsPerSample,
						       LC3FrameSize_t frameSize, uint8_t *buffer,
						       uint16_t *bufferSize, int32_t *result);
LC3DecoderHandle_t fake_LC3DecodeSessionOpen__fails(uint16_t sampleRate, uint8_t bitsPerSample,
						    LC3FrameSize_t frameSize, uint8_t *buffer,
						    uint16_t *bufferSize, int32_t *result);
int32_t fake_LC3DecodeSessionData__succeeds(LC3DecoderHandle_t decodeHandle,
					    LC3DecodeInput_t *decodeInput,
					    LC3DecodeOutput_t *decodeOutput);
int32_t fake_LC3DecodeSessionData__fails(LC3DecoderHandle_t decodeHandle,
					 LC3DecodeInput_t *decodeInput,
					 LC3DecodeOutput_t *decodeOutput);
void fake_LC3DecodeSessionClose__succeeds(LC3DecoderHandle_t decodeHandle);
void fake_LC3DecodeSessionClose__fails(LC3DecoderHandle_t decodeHandle);
uint16_t fake_LC3BitstreamBuffersize__succeeds(uint16_t sampleRate, uint32_t maxBitRate,
					       LC3FrameSize_t frameSize, int32_t *result);
uint16_t fake_LC3BitstreamBuffersize__fails(uint16_t sampleRate, uint32_t maxBitRate,
					    LC3FrameSize_t frameSize, int32_t *result);
uint16_t fake_LC3PCMBuffersize__succeeds(uint16_t sampleRate, uint8_t bitDepth,
					 LC3FrameSize_t frameSize, int32_t *result);
uint16_t fake_LC3PCMBuffersize__fails(uint16_t sampleRate, uint8_t bitDepth,
				      LC3FrameSize_t frameSize, int32_t *result);

extern uint8_t *wav_out;
extern int test_dec_out_size;

#endif /* _FAKES_H_ */
```

## src/sweep21ms_16b48khz_mono_lc3_ref.h
```c
/*
 * Copyright (c) 2023 Nordic Semiconductor ASA
 *
 * SPDX-License-Identifier:  LicenseRef-Nordic-5-Clause
 */

#ifndef _LC3_REF_H_
#define _LC3_REF_H_

#include <stdint.h>

#define LC3_MONO_REF_SIZE (384)

uint8_t lc3_mono_ref[LC3_MONO_REF_SIZE] = {
	0x1C, 0xCC, 0x12, 0x00, 0xE0, 0x01, 0xC0, 0x03, 0x01, 0x00, 0xE8, 0x03, 0x00, 0x00, 0xE8,
	0x03, 0x00, 0x00, 0x78, 0x00, 0x45, 0x0B, 0x24, 0xBE, 0x5E, 0xAC, 0xFA, 0x38, 0xEE, 0x5B,
	0xFD, 0x7C, 0x8B, 0x9E, 0xF8, 0xC9, 0xF7, 0xED, 0xB9, 0x2C, 0x2A, 0xB3, 0x73, 0x7A, 0x1B,
	0x99, 0x1B, 0x65, 0x5E, 0x44, 0x7D, 0x5A, 0x3A, 0xDE, 0x9F, 0x2F, 0xD8, 0x1B, 0x65, 0xE4,
	0x2E, 0x21, 0x8D, 0x82, 0x21, 0x03, 0x35, 0x00, 0x15, 0xA9, 0xDE, 0x67, 0xA1, 0xF0, 0x00,
	0x00, 0x05, 0x5A, 0x78, 0xE2, 0x7F, 0x08, 0xAB, 0xFE, 0x0B, 0x91, 0xEA, 0x8B, 0x7E, 0x9B,
	0x1E, 0xB4, 0xFE, 0xBE, 0x7C, 0xAC, 0xC7, 0x0B, 0xE8, 0x2F, 0xA0, 0x86, 0x31, 0x5F, 0x5F,
	0x47, 0x2A, 0xF0, 0x3C, 0x47, 0x06, 0x52, 0xFB, 0x08, 0x14, 0xF2, 0x36, 0x17, 0xB2, 0x16,
	0x1F, 0x65, 0x08, 0x3B, 0x23, 0x72, 0x3C, 0x16, 0x01, 0x71, 0xC2, 0xA2, 0xBF, 0x14, 0xAA,
	0x33, 0x9C, 0x3A, 0xA6, 0x3C, 0x78, 0x00, 0x6A, 0x58, 0x75, 0x1A, 0x61, 0x1E, 0xBE, 0xE5,
	0xE8, 0x7A, 0x7D, 0xB0, 0x4D, 0x06, 0x71, 0x53, 0xB9, 0x60, 0xF3, 0x10, 0x1A, 0x03, 0xFB,
	0x47, 0x29, 0x23, 0x12, 0x5A, 0x05, 0x01, 0xA5, 0xB4, 0x20, 0x6F, 0xEA, 0xEF, 0x11, 0x39,
	0xE1, 0x0E, 0x13, 0x21, 0x45, 0x62, 0x4F, 0x18, 0xD8, 0xF9, 0x04, 0xD9, 0x70, 0xCA, 0xF0,
	0xF1, 0x61, 0xC7, 0xD2, 0x3D, 0x2D, 0xF6, 0x87, 0xC8, 0xC6, 0x43, 0x16, 0xCD, 0xD5, 0xAB,
	0xF0, 0x4D, 0xBF, 0xFF, 0x00, 0x00, 0x1F, 0xFC, 0x03, 0xF8, 0x1F, 0x83, 0xE1, 0xE0, 0x74,
	0x7F, 0xC4, 0xB9, 0x42, 0x73, 0x22, 0xCC, 0xD6, 0xD0, 0xDC, 0x06, 0xB4, 0xB2, 0x27, 0x4B,
	0xF2, 0x35, 0x3E, 0x21, 0xC2, 0xE5, 0x83, 0x59, 0x65, 0x69, 0x29, 0x8D, 0x65, 0x92, 0xE0,
	0xF9, 0x9C, 0x08, 0xD6, 0x3F, 0x93, 0x84, 0x78, 0x00, 0xA3, 0xDB, 0xB6, 0x61, 0x33, 0x77,
	0xF9, 0x63, 0x88, 0x1B, 0xC6, 0x03, 0x73, 0x20, 0x04, 0xFF, 0xEF, 0xE8, 0x38, 0x01, 0x35,
	0x97, 0x6A, 0x6D, 0x93, 0xDF, 0x1C, 0x26, 0x0E, 0x99, 0x82, 0x14, 0xCB, 0x08, 0xCF, 0x19,
	0x95, 0x4A, 0x6D, 0x13, 0xCD, 0xDF, 0xEF, 0x17, 0xF1, 0xF6, 0xC5, 0xFA, 0x41, 0xA0, 0x9B,
	0x45, 0x6E, 0xCE, 0xD6, 0x87, 0xCF, 0x9E, 0x05, 0x1C, 0x31, 0x38, 0x7B, 0xAB, 0x9B, 0x60,
	0x8F, 0xA2, 0x18, 0xC8, 0x70, 0x81, 0xEA, 0xAE, 0x06, 0xF6, 0x11, 0x45, 0xA2, 0xBA, 0x17,
	0xA5, 0x72, 0x02, 0xAF, 0x2A, 0xA5, 0x56, 0x35, 0x4A, 0x8A, 0x6D, 0x0F, 0xC5, 0x51, 0xA9,
	0x25, 0x5B, 0x1A, 0x94, 0xF1, 0xB7, 0xF1, 0x0C, 0xC0, 0xD4, 0xFB, 0x1D, 0x6B, 0x62, 0xF9,
	0x61, 0x83, 0xB9, 0x3F, 0xE9, 0xF1, 0x3D, 0x75, 0x2C,
};

#endif /* _LC3_REF_H_ */
```

## src/sweep21ms_16b48khz_stereo_lc3_in.h
```c
/*
 * Copyright (c) 2023 Nordic Semiconductor ASA
 *
 * SPDX-License-Identifier:  LicenseRef-Nordic-5-Clause
 */

#ifndef _LC3_STEREO_IN_H_
#define _LC3_STEREO_IN_H_

#include <stdint.h>

#define LC3_STEREO_IN_SIZE (384)

uint8_t lc3_stereo_in[LC3_STEREO_IN_SIZE] = {
	0x1C, 0xCC, 0x12, 0x00, 0xE0, 0x01, 0xC0, 0x03, 0x02, 0x00, 0xE8, 0x03, 0x00, 0x00, 0xE8,
	0x03, 0x00, 0x00, 0x78, 0x00, 0x45, 0x06, 0x17, 0xCC, 0x03, 0xD7, 0x05, 0x57, 0x61, 0xD3,
	0x97, 0x12, 0x46, 0x25, 0xB5, 0x98, 0x48, 0xDC, 0x2E, 0x1B, 0xBE, 0x32, 0x70, 0xD6, 0x37,
	0x4B, 0xA0, 0x00, 0x00, 0x00, 0x00, 0x01, 0xDA, 0xDD, 0xB6, 0x5D, 0x78, 0xF8, 0x1F, 0x21,
	0x6A, 0x31, 0xBE, 0x90, 0xC7, 0xFE, 0x5C, 0xC8, 0xF2, 0x73, 0x13, 0x50, 0xC3, 0x31, 0x7A,
	0xE6, 0x1C, 0x9B, 0x56, 0x04, 0xC4, 0xEB, 0x65, 0x31, 0xA3, 0x3D, 0x68, 0x67, 0x67, 0xAF,
	0xBD, 0xF3, 0xE2, 0xD6, 0xC0, 0xE0, 0x89, 0x19, 0x7F, 0x97, 0x75, 0x99, 0x95, 0xFE, 0xD5,
	0x0F, 0x91, 0xD1, 0xD6, 0x99, 0xA3, 0x06, 0x7E, 0xD9, 0x34, 0xAE, 0x77, 0xA6, 0x90, 0x46,
	0xDE, 0xD5, 0xB6, 0x63, 0x8E, 0x38, 0x7C, 0x08, 0xFF, 0xFE, 0x7F, 0x74, 0xC9, 0xB2, 0x4C,
	0xED, 0xB3, 0x3F, 0x72, 0x9C, 0x78, 0x00, 0x6A, 0x58, 0x8A, 0x71, 0x6D, 0x97, 0x8E, 0x77,
	0x55, 0x6D, 0xEE, 0x7A, 0x1F, 0x33, 0xFC, 0xC9, 0xC0, 0xE3, 0x43, 0x2A, 0xEA, 0x34, 0x1F,
	0xB7, 0xA7, 0xF8, 0xE8, 0x0B, 0xA5, 0x68, 0xA6, 0x94, 0xDD, 0xFF, 0x0C, 0x0D, 0x39, 0xA7,
	0x20, 0xCE, 0x31, 0x99, 0x99, 0x99, 0x96, 0x6B, 0x85, 0x5C, 0x67, 0x76, 0x76, 0x15, 0xCC,
	0xF8, 0x06, 0x89, 0xC6, 0x3F, 0xB3, 0x84, 0x61, 0x59, 0xDA, 0x91, 0xEE, 0x03, 0x2B, 0xBD,
	0x77, 0x2F, 0x68, 0x88, 0x61, 0xD6, 0x74, 0xA3, 0xF2, 0x87, 0x69, 0x03, 0x07, 0xB1, 0x62,
	0xA1, 0xE3, 0x41, 0x4C, 0xA1, 0xD8, 0x6C, 0x5C, 0x4B, 0xE8, 0xA5, 0x3C, 0xCD, 0x2E, 0x0D,
	0x4E, 0xD5, 0x52, 0xD5, 0x0B, 0xFD, 0x88, 0xCE, 0x21, 0x40, 0x3E, 0xE8, 0x9B, 0x81, 0xC6,
	0xFE, 0x30, 0x92, 0x2D, 0xBD, 0xE3, 0x8C, 0x78, 0x00, 0xA3, 0xDB, 0x68, 0xF9, 0xDE, 0xC7,
	0xA4, 0x0D, 0x5E, 0x24, 0x95, 0xF6, 0xC5, 0xF1, 0x02, 0xB5, 0x59, 0xB6, 0xB1, 0xC4, 0xB8,
	0xAF, 0x5D, 0x25, 0x4F, 0xC4, 0x3F, 0xED, 0xF1, 0xB6, 0x6D, 0xE9, 0xC1, 0x20, 0x9E, 0x6A,
	0xBB, 0x63, 0x7E, 0x0A, 0x88, 0x9D, 0xB5, 0x6A, 0xC5, 0xB4, 0x9A, 0xDF, 0x00, 0xE4, 0x56,
	0xA6, 0xA3, 0xB9, 0x0A, 0xE9, 0xF1, 0x3D, 0x74, 0xDC, 0xF9, 0x88, 0x7C, 0x2F, 0x06, 0x1D,
	0x7E, 0x6C, 0xD8, 0x45, 0x4B, 0x66, 0xA1, 0x7B, 0xDE, 0x11, 0xE2, 0x33, 0xAA, 0x3E, 0x3C,
	0xFB, 0x8F, 0x97, 0x33, 0x7E, 0xD2, 0xFD, 0xF6, 0x7C, 0xA8, 0xB6, 0x1E, 0x23, 0xC1, 0xEB,
	0xBC, 0x9E, 0x70, 0xF8, 0x5E, 0x82, 0xC3, 0xB5, 0x9B, 0x97, 0x61, 0x25, 0xA2, 0x5B, 0x49,
	0xE8, 0xDD, 0xEA, 0x79, 0x62, 0x38, 0x3B, 0x82, 0x8C,
};

#endif /* _LC3_STEREO_IN_H_ */
```

## src/sweep21ms_16b48khz_stereo_lc3_ref.h
```c
/*
 * Copyright (c) 2023 Nordic Semiconductor ASA
 *
 * SPDX-License-Identifier:  LicenseRef-Nordic-5-Clause
 */

#ifndef _LC3_STEREO_REF_H_
#define _LC3_STEREO_REF_H_

#include <stdint.h>

#define LC3_STEREO_REF_SIZE (384)

uint8_t lc3_stereo_ref[LC3_STEREO_REF_SIZE] = {
	0x1C, 0xCC, 0x12, 0x00, 0xE0, 0x01, 0xC0, 0x03, 0x02, 0x00, 0xE8, 0x03, 0x00, 0x00, 0xE8,
	0x03, 0x00, 0x00, 0x78, 0x00, 0x45, 0x06, 0x17, 0xCC, 0x03, 0xD7, 0x05, 0x57, 0x61, 0xD3,
	0x97, 0x12, 0x46, 0x25, 0xB5, 0x98, 0x48, 0xDC, 0x2E, 0x1B, 0xBE, 0x32, 0x70, 0xD6, 0x37,
	0x4B, 0xA0, 0x00, 0x00, 0x00, 0x00, 0x01, 0xDA, 0xDD, 0xB6, 0x5D, 0x78, 0xF8, 0x1F, 0x21,
	0x6A, 0x31, 0xBE, 0x90, 0xC7, 0xFE, 0x5C, 0xC8, 0xF2, 0x73, 0x13, 0x50, 0xC3, 0x31, 0x7A,
	0xE6, 0x1C, 0x9B, 0x56, 0x04, 0xC4, 0xEB, 0x65, 0x31, 0xA3, 0x3D, 0x68, 0x67, 0x67, 0xAF,
	0xBD, 0xF3, 0xE2, 0xD6, 0xC0, 0xE0, 0x89, 0x19, 0x7F, 0x97, 0x75, 0x99, 0x95, 0xFE, 0xD5,
	0x0F, 0x91, 0xD1, 0xD6, 0x99, 0xA3, 0x06, 0x7E, 0xD9, 0x34, 0xAE, 0x77, 0xA6, 0x90, 0x46,
	0xDE, 0xD5, 0xB6, 0x63, 0x8E, 0x38, 0x7C, 0x08, 0xFF, 0xFE, 0x7F, 0x74, 0xC9, 0xB2, 0x4C,
	0xED, 0xB3, 0x3F, 0x72, 0x9C, 0x78, 0x00, 0x6A, 0x58, 0x8A, 0x71, 0x6D, 0x97, 0x8E, 0x77,
	0x55, 0x6D, 0xEE, 0x7A, 0x1F, 0x33, 0xFC, 0xC9, 0xC0, 0xE3, 0x43, 0x2A, 0xEA, 0x34, 0x1F,
	0xB7, 0xA7, 0xF8, 0xE8, 0x0B, 0xA5, 0x68, 0xA6, 0x94, 0xDD, 0xFF, 0x0C, 0x0D, 0x39, 0xA7,
	0x20, 0xCE, 0x31, 0x99, 0x99, 0x99, 0x96, 0x6B, 0x85, 0x5C, 0x67, 0x76, 0x76, 0x15, 0xCC,
	0xF8, 0x06, 0x89, 0xC6, 0x3F, 0xB3, 0x84, 0x61, 0x59, 0xDA, 0x91, 0xEE, 0x03, 0x2B, 0xBD,
	0x77, 0x2F, 0x68, 0x88, 0x61, 0xD6, 0x74, 0xA3, 0xF2, 0x87, 0x69, 0x03, 0x07, 0xB1, 0x62,
	0xA1, 0xE3, 0x41, 0x4C, 0xA1, 0xD8, 0x6C, 0x5C, 0x4B, 0xE8, 0xA5, 0x3C, 0xCD, 0x2E, 0x0D,
	0x4E, 0xD5, 0x52, 0xD5, 0x0B, 0xFD, 0x88, 0xCE, 0x21, 0x40, 0x3E, 0xE8, 0x9B, 0x81, 0xC6,
	0xFE, 0x30, 0x92, 0x2D, 0xBD, 0xE3, 0x8C, 0x78, 0x00, 0xA3, 0xDB, 0x68, 0xF9, 0xDE, 0xC7,
	0xA4, 0x0D, 0x5E, 0x24, 0x95, 0xF6, 0xC5, 0xF1, 0x02, 0xB5, 0x59, 0xB6, 0xB1, 0xC4, 0xB8,
	0xAF, 0x5D, 0x25, 0x4F, 0xC4, 0x3F, 0xED, 0xF1, 0xB6, 0x6D, 0xE9, 0xC1, 0x20, 0x9E, 0x6A,
	0xBB, 0x63, 0x7E, 0x0A, 0x88, 0x9D, 0xB5, 0x6A, 0xC5, 0xB4, 0x9A, 0xDF, 0x00, 0xE4, 0x56,
	0xA6, 0xA3, 0xB9, 0x0A, 0xE9, 0xF1, 0x3D, 0x74, 0xDC, 0xF9, 0x88, 0x7C, 0x2F, 0x06, 0x1D,
	0x7E, 0x6C, 0xD8, 0x45, 0x4B, 0x66, 0xA1, 0x7B, 0xDE, 0x11, 0xE2, 0x33, 0xAA, 0x3E, 0x3C,
	0xFB, 0x8F, 0x97, 0x33, 0x7E, 0xD2, 0xFD, 0xF6, 0x7C, 0xA8, 0xB6, 0x1E, 0x23, 0xC1, 0xEB,
	0xBC, 0x9E, 0x70, 0xF8, 0x5E, 0x82, 0xC3, 0xB5, 0x9B, 0x97, 0x61, 0x25, 0xA2, 0x5B, 0x49,
	0xE8, 0xDD, 0xEA, 0x79, 0x62, 0x38, 0x3B, 0x82, 0x8C,
};

#endif /* _LC3_STEREO_REF_H_ */
```

## src/sweep21ms_16b48khz_stereo_wav_in.h
```c
/*
 * Copyright (c) 2023 Nordic Semiconductor ASA
 *
 * SPDX-License-Identifier:  LicenseRef-Nordic-5-Clause
 */

#ifndef _WAV_STEREO_IN_H_
#define _WAV_STEREO_IN_H_

#include <stdint.h>

#define WAV_STEREO_IN_SIZE (2000)

uint16_t wav_stereo_in[WAV_STEREO_IN_SIZE] = {
	0x0014, 0xFEB2, 0x0050, 0xFF13, 0x0089, 0xF86E, 0x00D0, 0xF869, 0x0118, 0x0C33, 0x015A,
	0x064B, 0x01A5, 0xF5E5, 0x01E7, 0x02E2, 0x0233, 0x07F1, 0x027E, 0xFA49, 0x02C1, 0xF83C,
	0x0310, 0xF888, 0x0359, 0x0FB9, 0x03A5, 0x1A01, 0x03EE, 0xDEF5, 0x0437, 0xE922, 0x0487,
	0x28BA, 0x04CF, 0x00EE, 0x0520, 0xEA2A, 0x056B, 0xFB97, 0x05B7, 0xDC77, 0x060A, 0x0435,
	0x0654, 0x1B2E, 0x06A7, 0xCAB3, 0x06F8, 0x07B9, 0x0745, 0x3E9D, 0x0798, 0xC2A2, 0x07E8,
	0xF582, 0x083C, 0x47D9, 0x088F, 0xD368, 0x08E3, 0xF863, 0x0938, 0x271A, 0x0989, 0xC0E7,
	0x09E2, 0x157B, 0x0A36, 0x4155, 0x0A8B, 0xAFEF, 0x0AE5, 0xFDEE, 0x0B3A, 0x5660, 0x0B94,
	0xB088, 0x0BEC, 0xDF3B, 0x0C44, 0x7CD9, 0x0C9F, 0xD894, 0x0CFA, 0x9DA1, 0x0D54, 0x5163,
	0x0DAF, 0x1CD1, 0x0E0C, 0xBB1C, 0x0E67, 0x2644, 0x0EC6, 0x117F, 0x0F25, 0xAD51, 0x0F80,
	0x26D8, 0x0FE3, 0x5A17, 0x1041, 0xAB9E, 0x10A2, 0xBAD1, 0x1105, 0x7511, 0x1164, 0x2E1F,
	0x11C8, 0x8000, 0x122B, 0xED52, 0x128D, 0x7FFF, 0x12F3, 0xF15C, 0x1356, 0x9279, 0x13BC,
	0x2322, 0x1422, 0x44EF, 0x1487, 0xCAFD, 0x14F0, 0xD5D8, 0x1557, 0x3A0E, 0x15BF, 0x0D2F,
	0x1629, 0xC5E8, 0x1692, 0x13F7, 0x16FD, 0x4088, 0x1769, 0xEBD1, 0x17D3, 0xC8D7, 0x183F,
	0x0D91, 0x18AC, 0x3164, 0x191B, 0xE99E, 0x1988, 0xC42D, 0x19F7, 0x1F49, 0x1A67, 0x4391,
	0x1AD6, 0xE118, 0x1B47, 0xAF0A, 0x1BBA, 0x0665, 0x1C29, 0x5321, 0x1C9D, 0x04F3, 0x1D11,
	0xA556, 0x1D82, 0xE727, 0x1DFA, 0x4A27, 0x1E6F, 0x3001, 0x1EE2, 0xDB6A, 0x1F5B, 0xC849,
	0x1FD0, 0x0EEE, 0x2049, 0x44A9, 0x20C2, 0x0663, 0x2139, 0xB59C, 0x21B4, 0xDC4B, 0x222E,
	0x36CC, 0x22A8, 0x3979, 0x2324, 0xE175, 0x23A1, 0xB538, 0x241C, 0x0751, 0x249A, 0x5905,
	0x251A, 0x2961, 0x2596, 0xBEF1, 0x2617, 0xB4E9, 0x2697, 0x2549, 0x2715, 0x6874, 0x2797,
	0x16F8, 0x281A, 0xAAF0, 0x289C, 0xB4A0, 0x291E, 0x23CA, 0x29A3, 0x602E, 0x2A26, 0x1138,
	0x2AAB, 0xA9B7, 0x2B31, 0xB635, 0x2BB4, 0x1ADC, 0x2C3E, 0x5F73, 0x2CC4, 0x359D, 0x2D49,
	0xCFF0, 0x2DD5, 0xB562, 0x2E5B, 0xF712, 0x2EE4, 0x3493, 0x2F6E, 0x35BD, 0x2FF7, 0xFD62,
	0x3084, 0xB779, 0x310E, 0xAC73, 0x319B, 0x02F7, 0x3227, 0x66B9, 0x32B3, 0x519A, 0x3342,
	0xD484, 0x33CC, 0x86B8, 0x345D, 0xC01F, 0x34EB, 0x392D, 0x3579, 0x6A77, 0x360A, 0x2BF2,
	0x3698, 0xD4CD, 0x372B, 0xB991, 0x37BA, 0xD9CC, 0x384B, 0x1FDB, 0x38DF, 0x55CD, 0x396C,
	0x30E0, 0x3A01, 0xD6F3, 0x3A93, 0xABA9, 0x3B25, 0xC3B7, 0x3BBA, 0xFCF9, 0x3C4B, 0x3B5B,
	0x3CE1, 0x5764, 0x3D74, 0x217B, 0x3E08, 0xB6CD, 0x3E9D, 0x9239, 0x3F31, 0xE5D1, 0x3FC6,
	0x438F, 0x405A, 0x59E2, 0x40F1, 0x35C2, 0x4184, 0xE907, 0x421A, 0xB1E1, 0x42B1, 0xB719,
	0x4342, 0xDD62, 0x43DC, 0x1F5E, 0x446F, 0x5961, 0x4503, 0x4DDA, 0x459D, 0xFF67, 0x462F,
	0xB621, 0x46C6, 0xAF5F, 0x4759, 0xDF0A, 0x47EE, 0x2203, 0x4887, 0x4FD5, 0x4917, 0x4ACC,
	0x49AE, 0x1B71, 0x4A42, 0xD59A, 0x4AD5, 0xA778, 0x4B6B, 0xB65A, 0x4BFC, 0xF2A0, 0x4C90,
	0x345C, 0x4D23, 0x552B, 0x4DB4, 0x46B6, 0x4E48, 0x0EE9, 0x4ED8, 0xCC66, 0x4F6A, 0xA822,
	0x4FF9, 0xB620, 0x5089, 0xF0D6, 0x5119, 0x35B9, 0x51A6, 0x5F1E, 0x5236, 0x52AE, 0x52C1,
	0x15BA, 0x534E, 0xCE47, 0x53D9, 0xA087, 0x5461, 0xA821, 0x54EF, 0xD998, 0x5575, 0x156B,
	0x55FC, 0x4871, 0x5685, 0x5E5C, 0x5708, 0x4BE9, 0x578F, 0x0DDE, 0x5811, 0xC19F, 0x5892,
	0x9564, 0x5915, 0x9C19, 0x5992, 0xD22D, 0x5A13, 0x1681, 0x5A8E, 0x4B01, 0x5B08, 0x6104,
	0x5B84, 0x4ED9, 0x5BF8, 0x1CF3, 0x5C71, 0xDBA9, 0x5CE5, 0xA9A5, 0x5D56, 0x9F2C, 0x5DC9,
	0xBDF2, 0x5E34, 0xF6A1, 0x5EA2, 0x2E4A, 0x5F0D, 0x58B0, 0x5F74, 0x6487, 0x5FDB, 0x4780,
	0x603F, 0x12B6, 0x60A2, 0xD5DE, 0x6101, 0xA50A, 0x615E, 0x9499, 0x61B9, 0xAD02, 0x620E,
	0xE46C, 0x6264, 0x2181, 0x62B6, 0x4FCB, 0x6306, 0x634E, 0x6353, 0x5A6C, 0x639C, 0x374B,
	0x63E1, 0x01D6, 0x6426, 0xC836, 0x6467, 0x9DC5, 0x64A1, 0x9777, 0x64DC, 0xB0A8, 0x6512,
	0xDD93, 0x6544, 0x1508, 0x6573, 0x44CD, 0x659D, 0x612F, 0x65C5, 0x6185, 0x65E7, 0x46B0,
	0x6606, 0x19F6, 0x6622, 0xE59A, 0x6635, 0xB827, 0x6649, 0x9DE9, 0x6659, 0xA0B5, 0x6660,
	0xBB05, 0x6667, 0xE32A, 0x6666, 0x14AF, 0x6660, 0x429B, 0x6658, 0x6259, 0x6648, 0x6860,
	0x6634, 0x50AF, 0x661B, 0x27C3, 0x65FD, 0xF988, 0x65DB, 0xD0A5, 0x65B1, 0xB27A, 0x6582,
	0xA18C, 0x654F, 0xA2F9, 0x6513, 0xB8A6, 0x64D4, 0xDEEE, 0x648E, 0x0BA8, 0x643F, 0x33FE,
	0x63EE, 0x50A3, 0x6395, 0x5E79, 0x6336, 0x5C98, 0x62D1, 0x4A82, 0x6263, 0x2898, 0x61F1,
	0xFB7F, 0x6176, 0xCEAB, 0x60F6, 0xABCA, 0x606F, 0x9AC2, 0x5FDE, 0x9EA2, 0x5F49, 0xB269,
	0x5EA9, 0xD235, 0x5E04, 0xF95D, 0x5D59, 0x21AB, 0x5CA3, 0x4371, 0x5BE8, 0x5950, 0x5B24,
	0x60FE, 0x5A58, 0x57CE, 0x5986, 0x415B, 0x58A8, 0x2081, 0x57C4, 0xFACF, 0x56D8, 0xD9A2,
	0x55E3, 0xBE19, 0x54E7, 0xAA8D, 0x53E1, 0xA209, 0x52D2, 0xA736, 0x51BC, 0xBAE2, 0x509C,
	0xD6E6, 0x4F73, 0xF837, 0x4E43, 0x1BCF, 0x4D09, 0x3C5B, 0x4BC7, 0x5520, 0x4A7B, 0x61FE,
	0x4926, 0x620E, 0x47CA, 0x555B, 0x4662, 0x3E18, 0x44F2, 0x1E90, 0x437A, 0xFA6B, 0x41F7,
	0xD796, 0x406E, 0xBA11, 0x3ED9, 0xA5F0, 0x3D3B, 0x9CCA, 0x3B96, 0x9EB6, 0x39E5, 0xAAF1,
	0x382D, 0xBF17, 0x366C, 0xDA7C, 0x34A1, 0xFB4D, 0x32D0, 0x1E4A, 0x30F3, 0x3E04, 0x2F0E,
	0x5523, 0x2D21, 0x62C7, 0x2B29, 0x668C, 0x292C, 0x6060, 0x2726, 0x5179, 0x2515, 0x3A9C,
	0x22FF, 0x1D35, 0x20DD, 0xFD18, 0x1EB5, 0xDDF3, 0x1C89, 0xC2EF, 0x1A50, 0xB017, 0x1815,
	0xA5A7, 0x15CE, 0xA1D3, 0x1380, 0xA3E9, 0x1132, 0xAB43, 0x0ED4, 0xB81E, 0x0C77, 0xCB14,
	0x0A12, 0xE513, 0x07A4, 0x0572, 0x0537, 0x2853, 0x02BF, 0x45E7, 0x0046, 0x57F4, 0xFDC8,
	0x5FAA, 0xFB43, 0x6064, 0xF8BC, 0x5D98, 0xF632, 0x5728, 0xF3A7, 0x4A57, 0xF114, 0x373D,
	0xEE83, 0x1E6E, 0xEBF1, 0x0371, 0xE95A, 0xE8E8, 0xE6C9, 0xCF49, 0xE431, 0xB9CF, 0xE199,
	0xA9BE, 0xDF09, 0x9FC0, 0xDC75, 0x9CCB, 0xD9E6, 0xA00C, 0xD757, 0xA857, 0xD4C9, 0xB52A,
	0xD245, 0xC6A5, 0xCFC2, 0xDB83, 0xCD41, 0xF1F6, 0xCAC9, 0x07E9, 0xC85A, 0x1D8C, 0xC5F0,
	0x340F, 0xC38D, 0x48E2, 0xC133, 0x58FA, 0xBEDF, 0x6179, 0xBC97, 0x6305, 0xBA5D, 0x6114,
	0xB827, 0x5B7B, 0xB606, 0x512C, 0xB3F4, 0x4227, 0xB1EA, 0x30B3, 0xAFF6, 0x1E87, 0xAE09,
	0x0A93, 0xAC23, 0xF427, 0xAA53, 0xDB3E, 0xA8AF, 0xC3B9, 0xA714, 0xB1EF, 0xA583, 0xA65A,
	0xA3FD, 0x9FF8, 0xA29D, 0x9BD2, 0xA158, 0x993B, 0xA014, 0x9B02, 0x9EE9, 0xA320, 0x9DE0,
	0xB1BC, 0x9CF0, 0xC378, 0x9C25, 0xD417, 0x9B72, 0xE442, 0x9ACF, 0xF69B, 0x9A50, 0x0B4E,
	0x99F4, 0x2073, 0x99B7, 0x32D3, 0x998F, 0x4120, 0x9988, 0x4C2D, 0x99B7, 0x557C, 0x99F6,
	0x5E0D, 0x9A53, 0x6411, 0x9AD9, 0x66C2, 0x9B76, 0x6516, 0x9C41, 0x5DEF, 0x9D23, 0x5375,
	0x9E45, 0x4623, 0x9FB9, 0x3661, 0xA132, 0x24F5, 0xA2B6, 0x12FE, 0xA44F, 0x02F9, 0xA611,
	0xF3E0, 0xA7E4, 0xE3D6, 0xA9C3, 0xD1B3, 0xAC2C, 0xBF36, 0xAEF4, 0xB028, 0xB1AC, 0xA4F9,
	0xB426, 0x9E45, 0xB6A3, 0x9B8F, 0xB9BA, 0x9B91, 0xBD07, 0x9D10, 0xC01E, 0x9E51, 0xC345,
	0xA14D, 0xC6E9, 0xA7E5, 0xCAD7, 0xB329, 0xCE6D, 0xC251, 0xD1DC, 0xD28A, 0xD584, 0xE3AE,
	0xD9E0, 0xF42B, 0xDEA7, 0x025A, 0xE318, 0x0F17, 0xE758, 0x1B8C, 0xEB91, 0x2965, 0xF045,
	0x37EC, 0xF50B, 0x446E, 0xF99E, 0x4E09, 0xFE62, 0x561D, 0x02AE, 0x5D8A, 0x06F9, 0x6405,
	0x0B63, 0x686E, 0x104C, 0x6918, 0x1609, 0x657C, 0x1AF3, 0x5E09, 0x1F56, 0x55B4, 0x237B,
	0x4EB3, 0x2796, 0x47E2, 0x2C3E, 0x405E, 0x3099, 0x3737, 0x3540, 0x2D77, 0x39CD, 0x22D7,
	0x3DA0, 0x1452, 0x417A, 0x02CD, 0x459E, 0xF0C2, 0x4A6D, 0xE251, 0x4E8D, 0xDA43, 0x5159,
	0xD3D1, 0x53AC, 0xC984, 0x5646, 0xBB37, 0x59B4, 0xAD06, 0x5C8E, 0xA3D8, 0x5E3B, 0xA05B,
	0x5FCE, 0x9E9C, 0x6210, 0x9C1D, 0x63E4, 0x9929, 0x63EF, 0x97A0, 0x63F6, 0x9AF5, 0x6513,
	0xA14A, 0x66BF, 0xA6DB, 0x675C, 0xABF8, 0x65ED, 0xB170, 0x6471, 0xB9EE, 0x6300, 0xC4DC,
	0x6113, 0xCDCD, 0x5F37, 0xD521, 0x5D9A, 0xDCFC, 0x5C71, 0xE6AC, 0x5A0B, 0xF1F5, 0x565E,
	0xFC69, 0x52BE, 0x05C3, 0x4E9E, 0x108E, 0x4A32, 0x1ED5, 0x4568, 0x2EA1, 0x4098, 0x3B5F,
	0x3C24, 0x42DD, 0x36AA, 0x465D, 0x3092, 0x49DB, 0x2ACE, 0x50ED, 0x2533, 0x5AA6, 0x1EFD,
	0x633D, 0x17B8, 0x6789, 0x112F, 0x6710, 0x0ADF, 0x6484, 0x03E4, 0x6291, 0xFD2B, 0x6251,
	0xF44A, 0x62D2, 0xEB51, 0x616B, 0xE61D, 0x5DAE, 0xE02F, 0x5905, 0xD834, 0x53D8, 0xD156,
	0x4ECA, 0xCBA1, 0x4AAC, 0xC6BE, 0x452A, 0xC144, 0x3BF8, 0xBAD1, 0x3101, 0xB55A, 0x260D,
	0xB0D3, 0x1C72, 0xAC4F, 0x13BA, 0xA824, 0x0970, 0xA536, 0xFF55, 0xA2E1, 0xF6EC, 0x9F5D,
	0xEFCE, 0x9BB7, 0xE950, 0x999A, 0xE177, 0x98B8, 0xD94A, 0x9915, 0xD0D6, 0x996C, 0xC731,
	0x98E8, 0xBEA5, 0x99C2, 0xB893, 0x9D65, 0xB516, 0xA376, 0xB24D, 0xA9B2, 0xAE77, 0xAE77,
	0xA9B2, 0xB24D, 0xA376, 0xB516, 0x9D65, 0xB893, 0x99C2, 0xBEA5, 0x98E8, 0xC731, 0x996C,
	0xD0D6, 0x9915, 0xD94A, 0x98B8, 0xE177, 0x999A, 0xE950, 0x9BB7, 0xEFCE, 0x9F5D, 0xF6EC,
	0xA2E1, 0xFF55, 0xA536, 0x0970, 0xA824, 0x13BA, 0xAC4F, 0x1C72, 0xB0D3, 0x260D, 0xB55A,
	0x3101, 0xBAD1, 0x3BF8, 0xC144, 0x452A, 0xC6BE, 0x4AAC, 0xCBA1, 0x4ECA, 0xD156, 0x53D8,
	0xD834, 0x5905, 0xE02F, 0x5DAE, 0xE61D, 0x616B, 0xEB51, 0x62D2, 0xF44A, 0x6251, 0xFD2B,
	0x6291, 0x03E4, 0x6484, 0x0ADF, 0x6710, 0x112F, 0x6789, 0x17B8, 0x633D, 0x1EFD, 0x5AA6,
	0x2533, 0x50ED, 0x2ACE, 0x49DB, 0x3092, 0x465D, 0x36AA, 0x42DD, 0x3C24, 0x3B5F, 0x4098,
	0x2EA1, 0x4568, 0x1ED5, 0x4A32, 0x108E, 0x4E9E, 0x05C3, 0x52BE, 0xFC69, 0x565E, 0xF1F5,
	0x5A0B, 0xE6AC, 0x5C71, 0xDCFC, 0x5D9A, 0xD521, 0x5F37, 0xCDCD, 0x6113, 0xC4DC, 0x6300,
	0xB9EE, 0x6471, 0xB170, 0x65ED, 0xABF8, 0x675C, 0xA6DB, 0x66BF, 0xA14A, 0x6513, 0x9AF5,
	0x63F6, 0x97A0, 0x63EF, 0x9929, 0x63E4, 0x9C1D, 0x6210, 0x9E9C, 0x5FCE, 0xA05B, 0x5E3B,
	0xA3D8, 0x5C8E, 0xAD06, 0x59B4, 0xBB37, 0x5646, 0xC984, 0x53AC, 0xD3D1, 0x5159, 0xDA43,
	0x4E8D, 0xE251, 0x4A6D, 0xF0C2, 0x459E, 0x02CD, 0x417A, 0x1452, 0x3DA0, 0x22D7, 0x39CD,
	0x2D77, 0x3540, 0x3737, 0x3099, 0x405E, 0x2C3E, 0x47E2, 0x2796, 0x4EB3, 0x237B, 0x55B4,
	0x1F56, 0x5E09, 0x1AF3, 0x657C, 0x1609, 0x6918, 0x104C, 0x686E, 0x0B63, 0x6405, 0x06F9,
	0x5D8A, 0x02AE, 0x561D, 0xFE62, 0x4E09, 0xF99E, 0x446E, 0xF50B, 0x37EC, 0xF045, 0x2965,
	0xEB91, 0x1B8C, 0xE758, 0x0F17, 0xE318, 0x025A, 0xDEA7, 0xF42B, 0xD9E0, 0xE3AE, 0xD584,
	0xD28A, 0xD1DC, 0xC251, 0xCE6D, 0xB329, 0xCAD7, 0xA7E5, 0xC6E9, 0xA14D, 0xC345, 0x9E51,
	0xC01E, 0x9D10, 0xBD07, 0x9B91, 0xB9BA, 0x9B8F, 0xB6A3, 0x9E45, 0xB426, 0xA4F9, 0xB1AC,
	0xB028, 0xAEF4, 0xBF36, 0xAC2C, 0xD1B3, 0xA9C3, 0xE3D6, 0xA7E4, 0xF3E0, 0xA611, 0x02F9,
	0xA44F, 0x12FE, 0xA2B6, 0x24F5, 0xA132, 0x3661, 0x9FB9, 0x4623, 0x9E45, 0x5375, 0x9D23,
	0x5DEF, 0x9C41, 0x6516, 0x9B76, 0x66C2, 0x9AD9, 0x6411, 0x9A53, 0x5E0D, 0x99F6, 0x557C,
	0x99B7, 0x4C2D, 0x9988, 0x4120, 0x998F, 0x32D3, 0x99B7, 0x2073, 0x99F4, 0x0B4E, 0x9A50,
	0xF69B, 0x9ACF, 0xE442, 0x9B72, 0xD417, 0x9C25, 0xC378, 0x9CF0, 0xB1BC, 0x9DE0, 0xA320,
	0x9EE9, 0x9B02, 0xA014, 0x993B, 0xA158, 0x9BD2, 0xA29D, 0x9FF8, 0xA3FD, 0xA65A, 0xA583,
	0xB1EF, 0xA714, 0xC3B9, 0xA8AF, 0xDB3E, 0xAA53, 0xF427, 0xAC23, 0x0A93, 0xAE09, 0x1E87,
	0xAFF6, 0x30B3, 0xB1EA, 0x4227, 0xB3F4, 0x512C, 0xB606, 0x5B7B, 0xB827, 0x6114, 0xBA5D,
	0x6305, 0xBC97, 0x6179, 0xBEDF, 0x58FA, 0xC133, 0x48E2, 0xC38D, 0x340F, 0xC5F0, 0x1D8C,
	0xC85A, 0x07E9, 0xCAC9, 0xF1F6, 0xCD41, 0xDB83, 0xCFC2, 0xC6A5, 0xD245, 0xB52A, 0xD4C9,
	0xA857, 0xD757, 0xA00C, 0xD9E6, 0x9CCB, 0xDC75, 0x9FC0, 0xDF09, 0xA9BE, 0xE199, 0xB9CF,
	0xE431, 0xCF49, 0xE6C9, 0xE8E8, 0xE95A, 0x0371, 0xEBF1, 0x1E6E, 0xEE83, 0x373D, 0xF114,
	0x4A57, 0xF3A7, 0x5728, 0xF632, 0x5D98, 0xF8BC, 0x6064, 0xFB43, 0x5FAA, 0xFDC8, 0x57F4,
	0x0046, 0x45E7, 0x02BF, 0x2853, 0x0537, 0x0572, 0x07A4, 0xE513, 0x0A12, 0xCB14, 0x0C77,
	0xB81E, 0x0ED4, 0xAB43, 0x1132, 0xA3E9, 0x1380, 0xA1D3, 0x15CE, 0xA5A7, 0x1815, 0xB017,
	0x1A50, 0xC2EF, 0x1C89, 0xDDF3, 0x1EB5, 0xFD18, 0x20DD, 0x1D35, 0x22FF, 0x3A9C, 0x2515,
	0x5179, 0x2726, 0x6060, 0x292C, 0x668C, 0x2B29, 0x62C7, 0x2D21, 0x5523, 0x2F0E, 0x3E04,
	0x30F3, 0x1E4A, 0x32D0, 0xFB4D, 0x34A1, 0xDA7C, 0x366C, 0xBF17, 0x382D, 0xAAF1, 0x39E5,
	0x9EB6, 0x3B96, 0x9CCA, 0x3D3B, 0xA5F0, 0x3ED9, 0xBA11, 0x406E, 0xD796, 0x41F7, 0xFA6B,
	0x437A, 0x1E90, 0x44F2, 0x3E18, 0x4662, 0x555B, 0x47CA, 0x620E, 0x4926, 0x61FE, 0x4A7B,
	0x5520, 0x4BC7, 0x3C5B, 0x4D09, 0x1BCF, 0x4E43, 0xF837, 0x4F73, 0xD6E6, 0x509C, 0xBAE2,
	0x51BC, 0xA736, 0x52D2, 0xA209, 0x53E1, 0xAA8D, 0x54E7, 0xBE19, 0x55E3, 0xD9A2, 0x56D8,
	0xFACF, 0x57C4, 0x2081, 0x58A8, 0x415B, 0x5986, 0x57CE, 0x5A58, 0x60FE, 0x5B24, 0x5950,
	0x5BE8, 0x4371, 0x5CA3, 0x21AB, 0x5D59, 0xF95D, 0x5E04, 0xD235, 0x5EA9, 0xB269, 0x5F49,
	0x9EA2, 0x5FDE, 0x9AC2, 0x606F, 0xABCA, 0x60F6, 0xCEAB, 0x6176, 0xFB7F, 0x61F1, 0x2898,
	0x6263, 0x4A82, 0x62D1, 0x5C98, 0x6336, 0x5E79, 0x6395, 0x50A3, 0x63EE, 0x33FE, 0x643F,
	0x0BA8, 0x648E, 0xDEEE, 0x64D4, 0xB8A6, 0x6513, 0xA2F9, 0x654F, 0xA18C, 0x6582, 0xB27A,
	0x65B1, 0xD0A5, 0x65DB, 0xF988, 0x65FD, 0x27C3, 0x661B, 0x50AF, 0x6634, 0x6860, 0x6648,
	0x6259, 0x6658, 0x429B, 0x6660, 0x14AF, 0x6666, 0xE32A, 0x6667, 0xBB05, 0x6660, 0xA0B5,
	0x6659, 0x9DE9, 0x6649, 0xB827, 0x6635, 0xE59A, 0x6622, 0x19F6, 0x6606, 0x46B0, 0x65E7,
	0x6185, 0x65C5, 0x612F, 0x659D, 0x44CD, 0x6573, 0x1508, 0x6544, 0xDD93, 0x6512, 0xB0A8,
	0x64DC, 0x9777, 0x64A1, 0x9DC5, 0x6467, 0xC836, 0x6426, 0x01D6, 0x63E1, 0x374B, 0x639C,
	0x5A6C, 0x6353, 0x634E, 0x6306, 0x4FCB, 0x62B6, 0x2181, 0x6264, 0xE46C, 0x620E, 0xAD02,
	0x61B9, 0x9499, 0x615E, 0xA50A, 0x6101, 0xD5DE, 0x60A2, 0x12B6, 0x603F, 0x4780, 0x5FDB,
	0x6487, 0x5F74, 0x58B0, 0x5F0D, 0x2E4A, 0x5EA2, 0xF6A1, 0x5E34, 0xBDF2, 0x5DC9, 0x9F2C,
	0x5D56, 0xA9A5, 0x5CE5, 0xDBA9, 0x5C71, 0x1CF3, 0x5BF8, 0x4ED9, 0x5B84, 0x6104, 0x5B08,
	0x4B01, 0x5A8E, 0x1681, 0x5A13, 0xD22D, 0x5992, 0x9C19, 0x5915, 0x9564, 0x5892, 0xC19F,
	0x5811, 0x0DDE, 0x578F, 0x4BE9, 0x5708, 0x5E5C, 0x5685, 0x4871, 0x55FC, 0x156B, 0x5575,
	0xD998, 0x54EF, 0xA821, 0x5461, 0xA087, 0x53D9, 0xCE47, 0x534E, 0x15BA, 0x52C1, 0x52AE,
	0x5236, 0x5F1E, 0x51A6, 0x35B9, 0x5119, 0xF0D6, 0x5089, 0xB620, 0x4FF9, 0xA822, 0x4F6A,
	0xCC66, 0x4ED8, 0x0EE9, 0x4E48, 0x46B6, 0x4DB4, 0x552B, 0x4D23, 0x345C, 0x4C90, 0xF2A0,
	0x4BFC, 0xB65A, 0x4B6B, 0xA778, 0x4AD5, 0xD59A, 0x4A42, 0x1B71, 0x49AE, 0x4ACC, 0x4917,
	0x4FD5, 0x4887, 0x2203, 0x47EE, 0xDF0A, 0x4759, 0xAF5F, 0x46C6, 0xB621, 0x462F, 0xFF67,
	0x459D, 0x4DDA, 0x4503, 0x5961, 0x446F, 0x1F5E, 0x43DC, 0xDD62, 0x4342, 0xB719, 0x42B1,
	0xB1E1, 0x421A, 0xE907, 0x4184, 0x35C2, 0x40F1, 0x59E2, 0x405A, 0x438F, 0x3FC6, 0xE5D1,
	0x3F31, 0x9239, 0x3E9D, 0xB6CD, 0x3E08, 0x217B, 0x3D74, 0x5764, 0x3CE1, 0x3B5B, 0x3C4B,
	0xFCF9, 0x3BBA, 0xC3B7, 0x3B25, 0xABA9, 0x3A93, 0xD6F3, 0x3A01, 0x30E0, 0x396C, 0x55CD,
	0x38DF, 0x1FDB, 0x384B, 0xD9CC, 0x37BA, 0xB991, 0x372B, 0xD4CD, 0x3698, 0x2BF2, 0x360A,
	0x6A77, 0x3579, 0x392D, 0x34EB, 0xC01F, 0x345D, 0x86B8, 0x33CC, 0xD484, 0x3342, 0x519A,
	0x32B3, 0x66B9, 0x3227, 0x02F7, 0x319B, 0xAC73, 0x310E, 0xB779, 0x3084, 0xFD62, 0x2FF7,
	0x35BD, 0x2F6E, 0x3493, 0x2EE4, 0xF712, 0x2E5B, 0xB562, 0x2DD5, 0xCFF0, 0x2D49, 0x359D,
	0x2CC4, 0x5F73, 0x2C3E, 0x1ADC, 0x2BB4, 0xB635, 0x2B31, 0xA9B7, 0x2AAB, 0x1138, 0x2A26,
	0x602E, 0x29A3, 0x23CA, 0x291E, 0xB4A0, 0x289C, 0xAAF0, 0x281A, 0x16F8, 0x2797, 0x6874,
	0x2715, 0x2549, 0x2697, 0xB4E9, 0x2617, 0xBEF1, 0x2596, 0x2961, 0x251A, 0x5905, 0x249A,
	0x0751, 0x241C, 0xB538, 0x23A1, 0xE175, 0x2324, 0x3979, 0x22A8, 0x36CC, 0x222E, 0xDC4B,
	0x21B4, 0xB59C, 0x2139, 0x0663, 0x20C2, 0x44A9, 0x2049, 0x0EEE, 0x1FD0, 0xC849, 0x1F5B,
	0xDB6A, 0x1EE2, 0x3001, 0x1E6F, 0x4A27, 0x1DFA, 0xE727, 0x1D82, 0xA556, 0x1D11, 0x04F3,
	0x1C9D, 0x5321, 0x1C29, 0x0665, 0x1BBA, 0xAF0A, 0x1B47, 0xE118, 0x1AD6, 0x4391, 0x1A67,
	0x1F49, 0x19F7, 0xC42D, 0x1988, 0xE99E, 0x191B, 0x3164, 0x18AC, 0x0D91, 0x183F, 0xC8D7,
	0x17D3, 0xEBD1, 0x1769, 0x4088, 0x16FD, 0x13F7, 0x1692, 0xC5E8, 0x1629, 0x0D2F, 0x15BF,
	0x3A0E, 0x1557, 0xD5D8, 0x14F0, 0xCAFD, 0x1487, 0x44EF, 0x1422, 0x2322, 0x13BC, 0x9279,
	0x1356, 0xF15C, 0x12F3, 0x7FFF, 0x128D, 0xED52, 0x122B, 0x8000, 0x11C8, 0x2E1F, 0x1164,
	0x7511, 0x1105, 0xBAD1, 0x10A2, 0xAB9E, 0x1041, 0x5A17, 0x0FE3, 0x26D8, 0x0F80, 0xAD51,
	0x0F25, 0x117F, 0x0EC6, 0x2644, 0x0E67, 0xBB1C, 0x0E0C, 0x1CD1, 0x0DAF, 0x5163, 0x0D54,
	0x9DA1, 0x0CFA, 0xD894, 0x0C9F, 0x7CD9, 0x0C44, 0xDF3B, 0x0BEC, 0xB088, 0x0B94, 0x5660,
	0x0B3A, 0xFDEE, 0x0AE5, 0xAFEF, 0x0A8B, 0x4155, 0x0A36, 0x157B, 0x09E2, 0xC0E7, 0x0989,
	0x271A, 0x0938, 0xF863, 0x08E3, 0xD368, 0x088F, 0x47D9, 0x083C, 0xF582, 0x07E8, 0xC2A2,
	0x0798, 0x3E9D, 0x0745, 0x07B9, 0x06F8, 0xCAB3, 0x06A7, 0x1B2E, 0x0654, 0x0435, 0x060A,
	0xDC77, 0x05B7, 0xFB97, 0x056B, 0xEA2A, 0x0520, 0x00EE, 0x04CF, 0x28BA, 0x0487, 0xE922,
	0x0437, 0xDEF5, 0x03EE, 0x1A01, 0x03A5, 0x0FB9, 0x0359, 0xF888, 0x0310, 0xF83C, 0x02C1,
	0xFA49, 0x027E, 0x07F1, 0x0233, 0x02E2, 0x01E7, 0xF5E5, 0x01A5, 0x064B, 0x015A, 0x0C33,
	0x0118, 0xF869, 0x00D0, 0xF86E, 0x0089, 0xFF13, 0x0050, 0xFEB2, 0x0014,
};

#endif /* _WAV_STEREO_IN_H_ */
```
