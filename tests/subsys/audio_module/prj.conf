## CMakeLists.txt
```
#
# Copyright (c) 2023 Nordic Semiconductor ASA
#
# SPDX-License-Identifier: LicenseRef-Nordic-5-Clause
#

cmake_minimum_required(VERSION 3.20.0)

find_package(Zephyr REQUIRED HINTS $ENV{ZEPHYR_BASE})
project("Audio module")

target_sources(app PRIVATE
	src/main.c
	src/fakes.c
	src/audio_module_test_common.c
	src/bad_param_test.c
	src/functional_test.c
)

target_include_directories(app PRIVATE ${ZEPHYR_NRF_MODULE_DIR}/include/audio_module)
```

## prj.conf
```kconfig
#
# Copyright (c) 2022 Nordic Semiconductor ASA
#
# SPDX-License-Identifier: LicenseRef-Nordic-5-Clause
#

CONFIG_ZTEST=y
CONFIG_ZTEST_NEW_API=y
CONFIG_ZTEST_STACK_SIZE=8196
CONFIG_IRQ_OFFLOAD=y
CONFIG_AUDIO_MODULE=y

# The large stack size can be optimized
CONFIG_MAIN_STACK_SIZE=16000

CONFIG_STACK_SENTINEL=y
```

## src/main.c
```c
/*
 * Copyright (c) 2023 Nordic Semiconductor ASA
 *
 * SPDX-License-Identifier: LicenseRef-Nordic-5-Clause
 */

#include <zephyr/fff.h>
#include <zephyr/ztest.h>
#include <errno.h>
#include "fakes.h"

/* This function runs before each test */
static void run_before(void *fixture)
{
	ARG_UNUSED(fixture);

	/* Register resets */
	DO_FOREACH_FAKE(RESET_FAKE);

	/* Reset common FFF internal structures */
	FFF_RESET_HISTORY();
}

//ZTEST_SUITE(suite_audio_module_bad_param, NULL, NULL, run_before, NULL, NULL);
ZTEST_SUITE(suite_audio_module_functional, NULL, NULL, run_before, NULL, NULL);
ZTEST_SUITE(suite_audio_module_template, NULL, NULL, run_before, NULL, NULL);
```

## src/audio_module_test_common.c
```c
/*
 * Copyright (c) 2023 Nordic Semiconductor ASA
 *
 * SPDX-License-Identifier: LicenseRef-Nordic-5-Clause
 */

#include <zephyr/ztest.h>
#include <zephyr/fff.h>
#include "audio_module/audio_module.h"

#include "audio_module_test_common.h"
#include "audio_module.h"
#include "fakes.h"

const char *TEST_INSTANCE_NAME = "Test instance";
const char *TEST_STRING = "This is a test string";
const uint32_t TEST_UINT32 = 0xDEADBEEF;

void test_context_set(struct mod_context *ctx, struct mod_config const *const config)
{
	memcpy(&ctx->test_string, TEST_STRING, sizeof(TEST_STRING));
	ctx->test_uint32 = TEST_UINT32;
	memcpy(&ctx->config, config, sizeof(struct mod_config));
	reset_fake_fifo_counter();
}

int test_open_function(struct audio_module_handle_private *handle,
		       struct audio_module_configuration const *const configuration)
{
	struct audio_module_handle *hdl = (struct audio_module_handle *)handle;
	struct mod_context *ctx = (struct mod_context *)hdl->context;
	struct mod_config *config = (struct mod_config *)configuration;

	test_context_set(ctx, config);
	memcpy(&ctx->test_string, TEST_STRING, sizeof(TEST_STRING));
	ctx->test_uint32 = TEST_UINT32;
	memcpy(&ctx->config, config, sizeof(struct mod_config));

	return 0;
}

int test_close_function(struct audio_module_handle_private *handle)
{
	ARG_UNUSED(handle);

	return 0;
}

int test_config_set_function(struct audio_module_handle_private *handle,
			     struct audio_module_configuration const *const configuration)
{
	struct audio_module_handle *hdl = (struct audio_module_handle *)handle;
	struct mod_context *ctx = (struct mod_context *)hdl->context;
	struct mod_config *config = (struct mod_config *)configuration;

	memcpy(&ctx->config, config, sizeof(struct mod_config));

	return 0;
}

int test_config_get_function(struct audio_module_handle_private const *const handle,
			     struct audio_module_configuration *configuration)
{
	struct audio_module_handle *hdl = (struct audio_module_handle *)handle;
	struct mod_context *ctx = (struct mod_context *)hdl->context;
	struct mod_config *config = (struct mod_config *)configuration;

	memcpy(config, &ctx->config, sizeof(struct mod_config));

	return 0;
}

int test_start_function(struct audio_module_handle_private *handle)
{
	struct audio_module_handle *hdl = (struct audio_module_handle *)handle;
	struct mod_context *ctx = (struct mod_context *)hdl->context;

	ctx->test_string = TEST_STRING;
	ctx->test_uint32 = TEST_UINT32;

	return 0;
}

int test_stop_function(struct audio_module_handle_private *handle)
{
	struct audio_module_handle *hdl = (struct audio_module_handle *)handle;
	struct mod_context *ctx = (struct mod_context *)hdl->context;

	ctx->test_string = TEST_STRING;
	ctx->test_uint32 = TEST_UINT32;

	return 0;
}

int test_data_process_function(struct audio_module_handle_private *handle,
			       struct audio_data const *const audio_data_rx,
			       struct audio_data *audio_data_tx)
{
	ARG_UNUSED(handle);

	memcpy(audio_data_tx, audio_data_rx, sizeof(struct audio_data));

	if (audio_data_rx->data != NULL && audio_data_tx->data != NULL) {
		memcpy(audio_data_tx->data, audio_data_rx->data, audio_data_rx->data_size);
	}
	audio_data_tx->data_size = audio_data_rx->data_size;

	return 0;
}
```

## src/audio_module_test_common.h
```c
/*
 * Copyright (c) 2023 Nordic Semiconductor ASA
 *
 * SPDX-License-Identifier: LicenseRef-Nordic-5-Clause
 */

#ifndef _COMMON_AUDIO_MODULE_TEST_H_
#define _COMMON_AUDIO_MODULE_TEST_H_

#include "audio_module/audio_module.h"

#define FAKE_FIFO_MSG_QUEUE_SIZE      (4)
#define FAKE_FIFO_MSG_QUEUE_DATA_SIZE (sizeof(struct audio_module_message))
#define FAKE_FIFO_NUM		      (4)

#define TEST_MOD_THREAD_STACK_SIZE (2048)
#define TEST_MOD_THREAD_PRIORITY   (4)
#define TEST_CONNECTIONS_NUM	   (5)
#define TEST_MODULES_NUM	   (TEST_CONNECTIONS_NUM - 1)
#define TEST_MOD_DATA_SIZE	   (40)

struct mod_config {
	int test_int1;
	int test_int2;
	int test_int3;
	int test_int4;
};

struct mod_context {
	const char *test_string;
	uint32_t test_uint32;

	struct mod_config config;
};

extern const char *TEST_INSTANCE_NAME;
extern const char *TEST_STRING;
extern const uint32_t TEST_UINT32;

/**
 * @brief Test function to set a module's context.
 *
 * @param ctx[out]    The module context to set
 * @param config[in]  Pointer to the module's configuration
 *
 * @return 0 if successful, error otherwise
 */
void test_context_set(struct mod_context *ctx, struct mod_config const *const config);

/**
 * @brief Test function to open a module.
 *
 * @param handle[in/out]     The handle to the module instance.
 * @param configuration[in]  Pointer to the module's configuration.
 *
 * @return 0 if successful, error otherwise.
 */
int test_open_function(struct audio_module_handle_private *handle,
		       struct audio_module_configuration const *const configuration);

/**
 * @brief Test function to close a module.
 *
 * @param handle[in/out]  The handle to the module instance.
 *
 * @return 0 if successful, error otherwise.
 */
int test_close_function(struct audio_module_handle_private *handle);

/**
 * @brief Test function to configure a module.
 *
 * @param handle[in/out]     The handle to the module instance.
 * @param configuration[in]  Pointer to the module's configuration to set.
 *
 * @return 0 if successful, error otherwise.
 */
int test_config_set_function(struct audio_module_handle_private *handle,
			     struct audio_module_configuration const *const configuration);

/**
 * @brief Test function to get the configuration of a module.
 *
 * @param handle[in]          The handle to the module instance.
 * @param configuration[out]  Pointer to the module's current configuration.
 *
 * @return 0 if successful, error otherwise.
 */
int test_config_get_function(struct audio_module_handle_private const *const handle,
			     struct audio_module_configuration *configuration);

/**
 * @brief Test start function of a module.
 *
 * @param handle[in/out]  The handle for the module to be started.
 *
 * @return 0 if successful, error otherwise.
 */
int test_start_function(struct audio_module_handle_private *handle);

/**
 * @brief Test stop function of a module.
 *
 * @param handle[in/out]  The handle for the module to be stopped.
 *
 * @return 0 if successful, error otherwise.
 */
int test_stop_function(struct audio_module_handle_private *handle);

/**
 * @brief Test process data function of a module.
 *
 * @param handle[in/out]      The handle to the module instance.
 * @param audio_data_rx[in]   Pointer to the input audio data or NULL for an input module.
 * @param audio_data_tx[out]  Pointer to the output audio data or NULL for an output module.
 *
 * @return 0 if successful, error otherwise.
 */
int test_data_process_function(struct audio_module_handle_private *handle,
			       struct audio_data const *const audio_data_rx,
			       struct audio_data *audio_data_tx);

#endif /* _COMMON_AUDIO_MODULE_TEST_H_ */
```

## src/audio_module_test_fakes.c
```c
/*
 * Copyright (c) 2023 Nordic Semiconductor ASA
 *
 * SPDX-License-Identifier: LicenseRef-Nordic-5-Clause
 */

#include <zephyr/ztest.h>
#include <zephyr/fff.h>
#include <data_fifo.h>

#include "audio_module_test_common.h"
#include "audio_module_test_fakes.h"

/* Overload the message buffer pointer with a point to one of the an arrays below */
int fifo_num;

struct test_slab_queue {
	size_t head;
	size_t tail;
	size_t size;
	struct k_sem sem;

	void **data[FAKE_FIFO_MSG_QUEUE_SIZE];
	struct audio_module_message msg[FAKE_FIFO_MSG_QUEUE_SIZE];
};

struct test_msg_fifo_queue {
	size_t head;
	size_t tail;
	size_t size;
	struct k_sem sem;

	void **data[FAKE_FIFO_MSG_QUEUE_SIZE];
};

/* FIFO "slab" */
/* FIFO "slab" */
static struct test_slab_queue test_fifo_slab[FAKE_FIFO_NUM];

/* FIFO "message" queue */
/* FIFO "message" queue */
static struct test_msg_fifo_queue test_fifo_msg_queue[FAKE_FIFO_NUM];

/*
 * Stubs are defined here, so that multiple *.c files can share them
 * without having linker issues.
 */
DEFINE_FFF_GLOBALS;

DEFINE_FAKE_VALUE_FUNC(int, data_fifo_pointer_first_vacant_get, struct data_fifo *, void **,
		       k_timeout_t);
DEFINE_FAKE_VALUE_FUNC(int, data_fifo_block_lock, struct data_fifo *, void **, size_t);
DEFINE_FAKE_VALUE_FUNC(int, data_fifo_pointer_last_filled_get, struct data_fifo *, void **,
		       size_t *, k_timeout_t);
DEFINE_FAKE_VOID_FUNC2(data_fifo_block_free, struct data_fifo *, void *);
DEFINE_FAKE_VALUE_FUNC(int, data_fifo_num_used_get, struct data_fifo *, uint32_t *, uint32_t *);
DEFINE_FAKE_VALUE_FUNC(int, data_fifo_empty, struct data_fifo *);
DEFINE_FAKE_VALUE_FUNC(int, data_fifo_uninit, struct data_fifo *);
DEFINE_FAKE_VALUE_FUNC(int, data_fifo_init, struct data_fifo *);
DEFINE_FAKE_VALUE_FUNC(bool, data_fifo_state, struct data_fifo *);

void reset_fake_fifo_counter(void)
{
	fifo_num = 0;
}

/* Custom fakes implementation */
int fake_data_fifo_pointer_first_vacant_get__succeeds(struct data_fifo *data_fifo, void **data,
						      k_timeout_t timeout)
{
	int ret;
	struct test_slab_queue *test_fifo_slab_data =
		(struct test_slab_queue *)data_fifo->slab_buffer;

	ret = k_sem_take(&test_fifo_slab_data->sem, timeout);

	*data = &test_fifo_slab_data->msg[test_fifo_slab_data->head];
	test_fifo_slab_data->head = (test_fifo_slab_data->head + 1) % test_fifo_slab_data->size;

	return 0;
}

int fake_data_fifo_pointer_first_vacant_get__timeout_fails(struct data_fifo *data_fifo, void **data,
							   k_timeout_t timeout)
{
	ARG_UNUSED(data_fifo);
	ARG_UNUSED(data);
	ARG_UNUSED(timeout);

	return -ENOMSG;
}

int fake_data_fifo_pointer_first_vacant_get__no_wait_fails(struct data_fifo *data_fifo, void **data,
							   k_timeout_t timeout)
{
	ARG_UNUSED(data_fifo);
	ARG_UNUSED(data);
	ARG_UNUSED(timeout);

	return -EAGAIN;
}

int fake_data_fifo_pointer_first_vacant_get__invalid_fails(struct data_fifo *data_fifo, void **data,
							   k_timeout_t timeout)
{
	ARG_UNUSED(data_fifo);
	ARG_UNUSED(data);
	ARG_UNUSED(timeout);

	return -EINVAL;
}

int fake_data_fifo_block_lock__succeeds(struct data_fifo *data_fifo, void **data, size_t size)
{
	ARG_UNUSED(size);
	struct test_msg_fifo_queue *test_fifo_msg =
		(struct test_msg_fifo_queue *)data_fifo->msgq_buffer;

	k_sem_give(&test_fifo_msg->sem);

	test_fifo_msg->data[test_fifo_msg->head] = *data;
	test_fifo_msg->head = (test_fifo_msg->head + 1) % test_fifo_msg->size;

	return 0;
}

int fake_data_fifo_block_lock__size_fails(struct data_fifo *data_fifo, void **data, size_t size)
{
	ARG_UNUSED(data_fifo);
	ARG_UNUSED(data);
	ARG_UNUSED(size);

	return -ENOMEM;
}

int fake_data_fifo_block_lock__size_0_fails(struct data_fifo *data_fifo, void **data, size_t size)
{
	ARG_UNUSED(data_fifo);
	ARG_UNUSED(data);
	ARG_UNUSED(size);

	return -EINVAL;
}

int fake_data_fifo_block_lock__put_fails(struct data_fifo *data_fifo, void **data, size_t size)
{
	ARG_UNUSED(data_fifo);
	ARG_UNUSED(data);
	ARG_UNUSED(size);

	return -ESPIPE;
}

int fake_data_fifo_pointer_last_filled_get__succeeds(struct data_fifo *data_fifo, void **data,
						     size_t *size, k_timeout_t timeout)
{
	int ret;
	struct audio_module_message *msg;
	struct test_msg_fifo_queue *test_fifo_msg =
		(struct test_msg_fifo_queue *)data_fifo->msgq_buffer;

	ret = k_sem_take(&test_fifo_msg->sem, timeout);

	msg = (struct audio_module_message *)test_fifo_msg->data[test_fifo_msg->tail];

	test_fifo_msg->data[test_fifo_msg->tail] = NULL;
	test_fifo_msg->tail = (test_fifo_msg->tail + 1) % test_fifo_msg->size;

	*data = msg;
	*size = sizeof(struct audio_module_message);

	return 0;
}

int fake_data_fifo_pointer_last_filled_get__no_wait_fails(struct data_fifo *data_fifo, void **data,
							  size_t *size, k_timeout_t timeout)
{
	ARG_UNUSED(data_fifo);
	ARG_UNUSED(data);
	ARG_UNUSED(size);
	ARG_UNUSED(timeout);

	return -ENOMSG;
}

int fake_data_fifo_pointer_last_filled_get__timeout_fails(struct data_fifo *data_fifo, void **data,
							  size_t *size, k_timeout_t timeout)
{
	ARG_UNUSED(data_fifo);
	ARG_UNUSED(data);
	ARG_UNUSED(size);
	ARG_UNUSED(timeout);

	return -EAGAIN;
}

void fake_data_fifo_block_free__succeeds(struct data_fifo *data_fifo, void *data)
{
	ARG_UNUSED(data);

	zassert_not_equal(data_fifo, NULL, "Data FIFO pointer is NULL");

	struct test_slab_queue *test_fifo_slab_data =
		(struct test_slab_queue *)data_fifo->slab_buffer;

	k_sem_give(&test_fifo_slab_data->sem);
	test_fifo_slab_data->tail = (test_fifo_slab_data->tail + 1) % test_fifo_slab_data->size;
}

int fake_data_fifo_num_used_get__succeeds(struct data_fifo *data_fifo, uint32_t *alloced_num,
					  uint32_t *locked_num)
{
	struct test_msg_fifo_queue *test_fifo_msg =
		(struct test_msg_fifo_queue *)data_fifo->msgq_buffer;

	*alloced_num = test_fifo_msg->head - test_fifo_msg->tail;
	*locked_num = k_sem_count_get(&test_fifo_msg->sem);

	return 0;
}

int fake_data_fifo_num_used_get__fails(struct data_fifo *data_fifo, uint32_t *alloced_num,
				       uint32_t *locked_num)
{
	ARG_UNUSED(data_fifo);
	ARG_UNUSED(alloced_num);
	ARG_UNUSED(locked_num);

	return -EACCES;
}

int fake_data_fifo_empty__succeeds(struct data_fifo *data_fifo)
{
	int ret;
	struct test_msg_fifo_queue *test_fifo_msg =
		(struct test_msg_fifo_queue *)data_fifo->msgq_buffer;
	struct test_slab_queue *test_fifo_slab_data =
		(struct test_slab_queue *)data_fifo->slab_buffer;

	zassert_not_equal(data_fifo, NULL, "Data FIFO pointer is NULL");

	test_fifo_msg->head = 0;
	test_fifo_msg->tail = 0;
	test_fifo_msg->size = FAKE_FIFO_MSG_QUEUE_SIZE;
	k_sem_reset(&test_fifo_msg->sem);

	test_fifo_slab_data->head = 0;
	test_fifo_slab_data->tail = 0;
	test_fifo_slab_data->size = FAKE_FIFO_MSG_QUEUE_SIZE;
	k_sem_init(&test_fifo_slab_data->sem, FAKE_FIFO_MSG_QUEUE_SIZE, FAKE_FIFO_MSG_QUEUE_SIZE);

	return 0;
}

int fake_data_fifo_empty__count_fails(struct data_fifo *data_fifo)
{
	ARG_UNUSED(data_fifo);

	return -EACCES;
}

int fake_data_fifo_empty__no_wait_fails(struct data_fifo *data_fifo)
{
	ARG_UNUSED(data_fifo);

	return -ENOMSG;
}

int fake_data_fifo_empty__slab_init_fails(struct data_fifo *data_fifo)
{
	ARG_UNUSED(data_fifo);

	return -EINVAL;
}

int fake_data_fifo_empty__timeout_fails(struct data_fifo *data_fifo)
{
	ARG_UNUSED(data_fifo);

	return -EAGAIN;
}

int fake_data_fifo_uninit__succeeds(struct data_fifo *data_fifo)
{
	int ret;

	if (data_fifo->initialized) {
		ret = data_fifo_empty(data_fifo);
		if (ret) {
			return ret;
		}

		data_fifo->initialized = false;
	}

	return 0;
}

int fake_data_fifo_uninit__fails(struct data_fifo *data_fifo)
{
	ARG_UNUSED(data_fifo);

	return -EINVAL;
}

int fake_data_fifo_init__succeeds(struct data_fifo *data_fifo)
{
	int ret;
	struct test_msg_fifo_queue *test_fifo_msg = &test_fifo_msg_queue[fifo_num];
	struct test_slab_queue *test_fifo_slab_data = &test_fifo_slab[fifo_num];

	zassert_not_equal(data_fifo, NULL, "Data FIFO pointer is NULL");

	data_fifo->msgq_buffer = (char *)test_fifo_msg;
	data_fifo->slab_buffer = (char *)test_fifo_slab_data;

	data_fifo->elements_max = FAKE_FIFO_MSG_QUEUE_SIZE;
	data_fifo->block_size_max = TEST_MOD_DATA_SIZE;
	data_fifo->initialized = true;

	fifo_num += 1;

	test_fifo_msg->head = 0;
	test_fifo_msg->tail = 0;
	test_fifo_msg->size = FAKE_FIFO_MSG_QUEUE_SIZE;
	k_sem_init(&test_fifo_msg->sem, 0, FAKE_FIFO_MSG_QUEUE_SIZE);

	test_fifo_slab_data->head = 0;
	test_fifo_slab_data->tail = 0;
	test_fifo_slab_data->size = FAKE_FIFO_MSG_QUEUE_SIZE;
	k_sem_init(&test_fifo_slab_data->sem, FAKE_FIFO_MSG_QUEUE_SIZE, FAKE_FIFO_MSG_QUEUE_SIZE);

	for (int i = 0; i < FAKE_FIFO_MSG_QUEUE_SIZE; i++) {
		test_fifo_slab_data->data[i] = (void **)&test_fifo_slab_data->msg[i];
	}

	data_fifo->initialized = true;

	return 0;
}

int fake_data_fifo_init__fails(struct data_fifo *data_fifo)
{
	ARG_UNUSED(data_fifo);

	return -EINVAL;
}

bool fake_data_fifo_state__succeeds(struct data_fifo *data_fifo)
{
	zassert_not_equal(data_fifo, NULL, "Data FIFO pointer is NULL");

	return data_fifo->initialized;
}
```

## src/audio_module_test_fakes.h
```c
/*
 * Copyright (c) 2023 Nordic Semiconductor ASA
 *
 * SPDX-License-Identifier: LicenseRef-Nordic-5-Clause
 */

#ifndef _FAKES_H_
#define _FAKES_H_

#include <zephyr/ztest.h>
#include <zephyr/fff.h>
#include <data_fifo.h>

#include "audio_module_test_common.h"

/* Fake functions declaration. */
DECLARE_FAKE_VALUE_FUNC(int, data_fifo_pointer_first_vacant_get, struct data_fifo *, void **,
			k_timeout_t);
DECLARE_FAKE_VALUE_FUNC(int, data_fifo_block_lock, struct data_fifo *, void **, size_t);
DECLARE_FAKE_VALUE_FUNC(int, data_fifo_pointer_last_filled_get, struct data_fifo *, void **,
			size_t *, k_timeout_t);
DECLARE_FAKE_VOID_FUNC2(data_fifo_block_free, struct data_fifo *, void *);
DECLARE_FAKE_VALUE_FUNC(int, data_fifo_num_used_get, struct data_fifo *, uint32_t *, uint32_t *);
DECLARE_FAKE_VALUE_FUNC(int, data_fifo_empty, struct data_fifo *);
DECLARE_FAKE_VALUE_FUNC(int, data_fifo_uninit, struct data_fifo *);
DECLARE_FAKE_VALUE_FUNC(int, data_fifo_init, struct data_fifo *);
DECLARE_FAKE_VALUE_FUNC(bool, data_fifo_state, struct data_fifo *);

/* List of fakes used by this unit tester */
#define DO_FOREACH_FAKE(FUNC)                                                                      \
	do {                                                                                       \
		FUNC(data_fifo_pointer_first_vacant_get)                                           \
		FUNC(data_fifo_block_lock)                                                         \
		FUNC(data_fifo_pointer_last_filled_get)                                            \
		FUNC(data_fifo_block_free)                                                         \
		FUNC(data_fifo_num_used_get)                                                       \
		FUNC(data_fifo_empty)                                                              \
		FUNC(data_fifo_uninit)                                                             \
		FUNC(data_fifo_init)                                                               \
		FUNC(data_fifo_state)                                                              \
	} while (0)

void reset_fake_fifo_counter(void);

int fake_data_fifo_pointer_first_vacant_get__succeeds(struct data_fifo *data_fifo, void **data,
						      k_timeout_t timeout);
int fake_data_fifo_pointer_first_vacant_get__timeout_fails(struct data_fifo *data_fifo, void **data,
							   k_timeout_t timeout);
int fake_data_fifo_pointer_first_vacant_get__no_wait_fails(struct data_fifo *data_fifo, void **data,
							   k_timeout_t timeout);
int fake_data_fifo_pointer_first_vacant_get__invalid_fails(struct data_fifo *data_fifo, void **data,
							   k_timeout_t timeout);
int fake_data_fifo_block_lock__succeeds(struct data_fifo *data_fifo, void **data, size_t size);
int fake_data_fifo_block_lock__size_fails(struct data_fifo *data_fifo, void **data, size_t size);
int fake_data_fifo_block_lock__size_0_fails(struct data_fifo *data_fifo, void **data, size_t size);
int fake_data_fifo_block_lock__put_fails(struct data_fifo *data_fifo, void **data, size_t size);
int fake_data_fifo_pointer_last_filled_get__succeeds(struct data_fifo *data_fifo, void **data,
						     size_t *size, k_timeout_t timeout);
int fake_data_fifo_pointer_last_filled_get__no_wait_fails(struct data_fifo *data_fifo, void **data,
							  size_t *size, k_timeout_t timeout);
int fake_data_fifo_pointer_last_filled_get__timeout_fails(struct data_fifo *data_fifo, void **data,
							  size_t *size, k_timeout_t timeout);
void fake_data_fifo_block_free__succeeds(struct data_fifo *data_fifo, void *data);
int fake_data_fifo_num_used_get__succeeds(struct data_fifo *data_fifo, uint32_t *alloced_num,
					  uint32_t *locked_num);
int fake_data_fifo_num_used_get__fails(struct data_fifo *data_fifo, uint32_t *alloced_num,
				       uint32_t *locked_num);
int fake_data_fifo_empty__succeeds(struct data_fifo *data_fifo);
int fake_data_fifo_empty__count_fails(struct data_fifo *data_fifo);
int fake_data_fifo_empty__no_wait_fails(struct data_fifo *data_fifo);
int fake_data_fifo_empty__slab_init_fails(struct data_fifo *data_fifo);
int fake_data_fifo_empty__timeout_fails(struct data_fifo *data_fifo);
int fake_data_fifo_uninit__succeeds(struct data_fifo *data_fifo);
int fake_data_fifo_uninit__fails(struct data_fifo *data_fifo);
int fake_data_fifo_init__succeeds(struct data_fifo *data_fifo);
int fake_data_fifo_init__fails(struct data_fifo *data_fifo);
bool fake_data_fifo_state__succeeds(struct data_fifo *data_fifo);

#endif /* _FAKES_H_ */
```

## src/common.c
```c
/*
 * Copyright (c) 2023 Nordic Semiconductor ASA
 *
 * SPDX-License-Identifier: LicenseRef-Nordic-5-Clause
 */

#include <zephyr/ztest.h>
#include <zephyr/fff.h>

#include "common.h"
#include "audio_module/audio_module.h"

const char *TEST_INSTANCE_NAME = "Test instance";
const char *TEST_STRING = "This is a test string";
const uint32_t TEST_UINT32 = 0XDEADBEEF;

/**
 * Test function to set a module's context.
 */
void test_context_set(struct mod_context *ctx, struct mod_config const *const config)
{
	memcpy(&ctx->test_string, TEST_STRING, sizeof(TEST_STRING));
	ctx->test_uint32 = TEST_UINT32;
	memcpy(&ctx->config, config, sizeof(struct mod_config));
}

/**
 * Test function to open a module.
 */
int test_open_function(struct audio_module_handle_private *handle,
		       struct audio_module_configuration const *const configuration)
{
	struct audio_module_handle *hdl = (struct audio_module_handle *)handle;
	struct mod_context *ctx = (struct mod_context *)hdl->context;
	struct mod_config *config = (struct mod_config *)configuration;

	test_context_set(ctx, config);
	memcpy(&ctx->test_string, TEST_STRING, sizeof(TEST_STRING));
	ctx->test_uint32 = TEST_UINT32;
	memcpy(&ctx->config, config, sizeof(struct mod_config));

	return 0;
}

/**
 * Test function to close a module.
 */
int test_close_function(struct audio_module_handle_private *handle)
{
	ARG_UNUSED(handle);

	return 0;
}

/**
 * Test function to configure a module.
 */
int test_config_set_function(struct audio_module_handle_private *handle,
			     struct audio_module_configuration const *const configuration)
{
	struct audio_module_handle *hdl = (struct audio_module_handle *)handle;
	struct mod_context *ctx = (struct mod_context *)hdl->context;
	struct mod_config *config = (struct mod_config *)configuration;

	memcpy(&ctx->config, config, sizeof(struct mod_config));

	return 0;
}

/**
 * Test function to get the configuration of a module.
 */
int test_config_get_function(struct audio_module_handle_private const *const handle,
			     struct audio_module_configuration *configuration)
{
	struct audio_module_handle *hdl = (struct audio_module_handle *)handle;
	struct mod_context *ctx = (struct mod_context *)hdl->context;
	struct mod_config *config = (struct mod_config *)configuration;

	memcpy(config, &ctx->config, sizeof(struct mod_config));

	return 0;
}

/**
 * Test stop/start function of a module.
 */
int test_stop_start_function(struct audio_module_handle_private *handle)
{
	struct audio_module_handle *hdl = (struct audio_module_handle *)handle;
	struct mod_context *ctx = (struct mod_context *)hdl->context;

	ctx->test_string = TEST_STRING;
	ctx->test_uint32 = TEST_UINT32;

	return 0;
}

/**
 * Test process data function of a module.
 */
int test_data_process_function(struct audio_module_handle_private *handle,
			       struct audio_data const *const audio_data_rx,
			       struct audio_data *audio_data_tx)
{
	ARG_UNUSED(handle);

	memcpy(audio_data_tx, audio_data_rx, sizeof(struct audio_data));
	memcpy(audio_data_tx->data, audio_data_rx->data, audio_data_rx->data_size);
	audio_data_tx->data_size = audio_data_rx->data_size;

	return 0;
}
```

## src/common.h
```c
/*
 * Copyright (c) 2023 Nordic Semiconductor ASA
 *
 * SPDX-License-Identifier: LicenseRef-Nordic-5-Clause
 */

#ifndef _COMMON_AUDIO_MODULE_TEST_H_
#define _COMMON_AUDIO_MODULE_TEST_H_

#include "audio_module/audio_module.h"

#define FAKE_FIFO_MSG_QUEUE_SIZE      (4)
#define FAKE_FIFO_MSG_QUEUE_DATA_SIZE (sizeof(struct audio_module_message))
#define FAKE_FIFO_NUM		      (4)

#define TEST_MOD_THREAD_STACK_SIZE (2048)
#define TEST_MOD_THREAD_PRIORITY   (4)
#define TEST_CONNECTIONS_NUM	   (5)
#define TEST_MODULES_NUM	   (TEST_CONNECTIONS_NUM - 1)
#define TEST_MOD_DATA_SIZE	   (40)

struct mod_config {
	int test_int1;
	int test_int2;
	int test_int3;
	int test_int4;
};

struct mod_context {
	const char *test_string;
	uint32_t test_uint32;

	struct mod_config config;
};

extern const char *TEST_INSTANCE_NAME;
extern const char *TEST_STRING;
extern const uint32_t TEST_UINT32;

/**
 * @brief Test function to set a module's context.
 *
 * @param ctx[out]    The module context to set
 * @param config[in]  Pointer to the module's configuration
 *
 * @return 0 if successful, error otherwise
 */
void test_context_set(struct mod_context *ctx, struct mod_config const *const config);

/**
 * @brief Test function to open a module.
 *
 * @param handle[in/out]     The handle to the module instance.
 * @param configuration[in]  Pointer to the module's configuration.
 *
 * @return 0 if successful, error otherwise.
 */
int test_open_function(struct audio_module_handle_private *handle,
		       struct audio_module_configuration const *const configuration);

/**
 * @brief Test function to close a module.
 *
 * @param handle[in/out]  The handle to the module instance.
 *
 * @return 0 if successful, error otherwise.
 */
int test_close_function(struct audio_module_handle_private *handle);

/**
 * @brief Test function to configure a module.
 *
 * @param handle[in/out]     The handle to the module instance.
 * @param configuration[in]  Pointer to the module's configuration to set.
 *
 * @return 0 if successful, error otherwise.
 */
int test_config_set_function(struct audio_module_handle_private *handle,
			     struct audio_module_configuration const *const configuration);

/**
 * @brief Test function to get the configuration of a module.
 *
 * @param handle[in]          The handle to the module instance.
 * @param configuration[out]  Pointer to the module's current configuration.
 *
 * @return 0 if successful, error otherwise.
 */
int test_config_get_function(struct audio_module_handle_private const *const handle,
			     struct audio_module_configuration *configuration);

/**
 * @brief Test stop/start function of a module.
 *
 * @param handle[in/out]  The handle for the module to be stopped or started.
 *
 * @return 0 if successful, error otherwise.
 */
int test_stop_start_function(struct audio_module_handle_private *handle);

/**
 * @brief Test process data function of a module.
 *
 * @param handle[in/out]      The handle to the module instance.
 * @param audio_data_rx[in]   Pointer to the input audio data or NULL for an input module.
 * @param audio_data_tx[out]  Pointer to the output audio data or NULL for an output module.
 *
 * @return 0 if successful, error otherwise.
 */
int test_data_process_function(struct audio_module_handle_private *handle,
			       struct audio_data const *const audio_data_rx,
			       struct audio_data *audio_data_tx);

#endif /* _COMMON_AUDIO_MODULE_TEST_H_ */
```

## src/fakes.c
```c
/*
 * Copyright (c) 2023 Nordic Semiconductor ASA
 *
 * SPDX-License-Identifier: LicenseRef-Nordic-5-Clause
 */

#include <zephyr/ztest.h>
#include <zephyr/fff.h>
#include <data_fifo.h>

#include "audio_module_test_common.h"
#include "fakes.h"

/* Overload the message buffer pointer with a point to one of the an arrays below */
int fifo_num;

struct test_slab_queue {
	size_t head;
	size_t tail;
	size_t size;
	size_t locked;

	void **data[FAKE_FIFO_MSG_QUEUE_SIZE];
	struct audio_module_message msg[FAKE_FIFO_MSG_QUEUE_SIZE];
};

struct test_msg_fifo_queue {
	size_t head;
	size_t tail;
	size_t size;
	size_t locked;

	void **data[FAKE_FIFO_MSG_QUEUE_SIZE];
};

/* FIFO "slab" */
static struct test_slab_queue test_fifo_slab[FAKE_FIFO_NUM];

/* FIFO "message" queue */
static struct test_msg_fifo_queue test_fifo_msg_queue[FAKE_FIFO_NUM];

/*
 * Stubs are defined here, so that multiple *.c files can share them
 * without having linker issues.
 */
DEFINE_FFF_GLOBALS;

DEFINE_FAKE_VALUE_FUNC(int, data_fifo_pointer_first_vacant_get, struct data_fifo *, void **,
		       k_timeout_t);
DEFINE_FAKE_VALUE_FUNC(int, data_fifo_block_lock, struct data_fifo *, void **, size_t);
DEFINE_FAKE_VALUE_FUNC(int, data_fifo_pointer_last_filled_get, struct data_fifo *, void **,
		       size_t *, k_timeout_t);
DEFINE_FAKE_VOID_FUNC2(data_fifo_block_free, struct data_fifo *, void *);
DEFINE_FAKE_VALUE_FUNC(int, data_fifo_num_used_get, struct data_fifo *, uint32_t *, uint32_t *);
DEFINE_FAKE_VALUE_FUNC(int, data_fifo_empty, struct data_fifo *);
DEFINE_FAKE_VALUE_FUNC(int, data_fifo_deinit, struct data_fifo *);
DEFINE_FAKE_VALUE_FUNC(int, data_fifo_init, struct data_fifo *);

void reset_fake_fifo_counter(void)
{
	fifo_num =0;
}

/* Custom fakes implementation */
int fake_data_fifo_pointer_first_vacant_get__succeeds(struct data_fifo *data_fifo, void **data,
						      k_timeout_t timeout)
{
	struct test_slab_queue *test_fifo_slab_data =
		(struct test_slab_queue *)data_fifo->slab_buffer;

	*data = &test_fifo_slab_data->msg[test_fifo_slab_data->head];
	test_fifo_slab_data->head = (test_fifo_slab_data->head + 1) % test_fifo_slab_data->size;

	return 0;
}

int fake_data_fifo_pointer_first_vacant_get__timeout_fails(struct data_fifo *data_fifo, void **data,
							   k_timeout_t timeout)
{
	ARG_UNUSED(data_fifo);
	ARG_UNUSED(data);
	ARG_UNUSED(timeout);

	return -ENOMSG;
}

int fake_data_fifo_pointer_first_vacant_get__no_wait_fails(struct data_fifo *data_fifo, void **data,
							   k_timeout_t timeout)
{
	ARG_UNUSED(data_fifo);
	ARG_UNUSED(data);
	ARG_UNUSED(timeout);

	return -EAGAIN;
}

int fake_data_fifo_pointer_first_vacant_get__invalid_fails(struct data_fifo *data_fifo, void **data,
							   k_timeout_t timeout)
{
	ARG_UNUSED(data_fifo);
	ARG_UNUSED(data);
	ARG_UNUSED(timeout);

	return -EINVAL;
}

int fake_data_fifo_block_lock__succeeds(struct data_fifo *data_fifo, void **data, size_t size)
{
	ARG_UNUSED(size);
	struct test_msg_fifo_queue *test_fifo_msg =
		(struct test_msg_fifo_queue *)data_fifo->msgq_buffer;

	test_fifo_msg->data[test_fifo_msg->head] = *data;
	test_fifo_msg->head = (test_fifo_msg->head + 1) % test_fifo_msg->size;

	test_fifo_msg->locked++;

	return 0;
}

int fake_data_fifo_block_lock__size_fails(struct data_fifo *data_fifo, void **data, size_t size)
{
	ARG_UNUSED(data_fifo);
	ARG_UNUSED(data);
	ARG_UNUSED(size);

	return -ENOMEM;
}

int fake_data_fifo_block_lock__size_0_fails(struct data_fifo *data_fifo, void **data, size_t size)
{
	ARG_UNUSED(data_fifo);
	ARG_UNUSED(data);
	ARG_UNUSED(size);

	return -EINVAL;
}

int fake_data_fifo_block_lock__put_fails(struct data_fifo *data_fifo, void **data, size_t size)
{
	ARG_UNUSED(data_fifo);
	ARG_UNUSED(data);
	ARG_UNUSED(size);

	return -ESPIPE;
}

int fake_data_fifo_pointer_last_filled_get__succeeds(struct data_fifo *data_fifo, void **data,
						     size_t *size, k_timeout_t timeout)
{
	struct audio_module_message *msg;
	struct test_msg_fifo_queue *test_fifo_msg =
		(struct test_msg_fifo_queue *)data_fifo->msgq_buffer;

	msg = (struct audio_module_message *)test_fifo_msg->data[test_fifo_msg->tail];

	test_fifo_msg->data[test_fifo_msg->tail] = NULL;
	test_fifo_msg->tail = (test_fifo_msg->tail + 1) % test_fifo_msg->size;

	*data = msg;
	*size = sizeof(struct audio_module_message);

	test_fifo_msg->locked--;

	return 0;
}

int fake_data_fifo_pointer_last_filled_get__no_wait_fails(struct data_fifo *data_fifo, void **data,
							  size_t *size, k_timeout_t timeout)
{
	ARG_UNUSED(data_fifo);
	ARG_UNUSED(data);
	ARG_UNUSED(size);
	ARG_UNUSED(timeout);

	return -ENOMSG;
}

int fake_data_fifo_pointer_last_filled_get__timeout_fails(struct data_fifo *data_fifo, void **data,
							  size_t *size, k_timeout_t timeout)
{
	ARG_UNUSED(data_fifo);
	ARG_UNUSED(data);
	ARG_UNUSED(size);
	ARG_UNUSED(timeout);

	return -EAGAIN;
}

void fake_data_fifo_block_free__succeeds(struct data_fifo *data_fifo, void *data)
{
	ARG_UNUSED(data);

	struct test_slab_queue *test_fifo_slab_data =
		(struct test_slab_queue *)data_fifo->slab_buffer;

	test_fifo_slab_data->tail = (test_fifo_slab_data->tail + 1) % test_fifo_slab_data->size;
}

int fake_data_fifo_num_used_get__succeeds(struct data_fifo *data_fifo, uint32_t *alloced_num,
					  uint32_t *locked_num)
{
	struct test_msg_fifo_queue *test_fifo_msg =
		(struct test_msg_fifo_queue *)data_fifo->msgq_buffer;

	*alloced_num = test_fifo_msg->head - test_fifo_msg->tail;
	*locked_num = test_fifo_msg->locked;

	return 0;
}

int fake_data_fifo_num_used_get__fails(struct data_fifo *data_fifo, uint32_t *alloced_num,
				       uint32_t *locked_num)
{
	ARG_UNUSED(data_fifo);
	ARG_UNUSED(alloced_num);
	ARG_UNUSED(locked_num);

	return -EACCES;
}

int fake_data_fifo_empty__succeeds(struct data_fifo *data_fifo)
{
	struct test_msg_fifo_queue *test_fifo_msg =
		(struct test_msg_fifo_queue *)data_fifo->msgq_buffer;
	struct test_slab_queue *test_fifo_slab_data =
		(struct test_slab_queue *)data_fifo->slab_buffer;

	test_fifo_msg->head = 0;
	test_fifo_msg->tail = 0;
	test_fifo_msg->size = FAKE_FIFO_MSG_QUEUE_SIZE;
	test_fifo_msg->locked = 0;

	test_fifo_slab_data->head = 0;
	test_fifo_slab_data->tail = 0;
	test_fifo_slab_data->size = FAKE_FIFO_MSG_QUEUE_SIZE;

	return 0;
}

int fake_data_fifo_empty__count_fails(struct data_fifo *data_fifo)
{
	ARG_UNUSED(data_fifo);

	return -EACCES;
}

int fake_data_fifo_empty__no_wait_fails(struct data_fifo *data_fifo)
{
	ARG_UNUSED(data_fifo);

	return -ENOMSG;
}

int fake_data_fifo_empty__slab_init_fails(struct data_fifo *data_fifo)
{
	ARG_UNUSED(data_fifo);

	return -EINVAL;
}

int fake_data_fifo_empty__timeout_fails(struct data_fifo *data_fifo)
{
	ARG_UNUSED(data_fifo);

	return -EAGAIN;
}

int fake_data_fifo_deinit__succeeds(struct data_fifo *data_fifo)
{
	int ret;

	ret = data_fifo_empty(data_fifo);
	if (ret) {
		return ret;
	}

	data_fifo->initialized = false;

	return 0;
}

int fake_data_fifo_deinit__fails(struct data_fifo *data_fifo)
{
	ARG_UNUSED(data_fifo);

	return -EINVAL;
}

int fake_data_fifo_init__succeeds(struct data_fifo *data_fifo)
{
	struct test_msg_fifo_queue *test_fifo_msg = &test_fifo_msg_queue[fifo_num];
	struct test_slab_queue *test_fifo_slab_data = &test_fifo_slab[fifo_num];

	data_fifo->msgq_buffer = (char *)test_fifo_msg;
	data_fifo->slab_buffer = (char *)test_fifo_slab_data;

	data_fifo->elements_max = FAKE_FIFO_MSG_QUEUE_SIZE;
	data_fifo->block_size_max = TEST_MOD_DATA_SIZE;
	data_fifo->initialized = true;

	fifo_num += 1;

	test_fifo_msg->head = 0;
	test_fifo_msg->tail = 0;
	test_fifo_msg->size = FAKE_FIFO_MSG_QUEUE_SIZE;
	test_fifo_msg->locked = 0;

	test_fifo_slab_data->head = 0;
	test_fifo_slab_data->tail = 0;
	test_fifo_slab_data->size = FAKE_FIFO_MSG_QUEUE_SIZE;

	for (int i = 0; i < FAKE_FIFO_MSG_QUEUE_SIZE; i++) {
		test_fifo_slab_data->data[i] =
			(void **)&test_fifo_slab_data->msg[i];
	}

	return 0;
}

int fake_data_fifo_init__fails(struct data_fifo *data_fifo)
{
	ARG_UNUSED(data_fifo);

	return -EINVAL;
}
```

## src/fakes.h
```c
/*
 * Copyright (c) 2023 Nordic Semiconductor ASA
 *
 * SPDX-License-Identifier: LicenseRef-Nordic-5-Clause
 */

#ifndef _FAKES_H_
#define _FAKES_H_

#include <zephyr/ztest.h>
#include <zephyr/fff.h>
#include <data_fifo.h>

#include "audio_module_test_common.h"

/* Fake functions declaration. */
DECLARE_FAKE_VALUE_FUNC(int, data_fifo_pointer_first_vacant_get, struct data_fifo *, void **,
			k_timeout_t);
DECLARE_FAKE_VALUE_FUNC(int, data_fifo_block_lock, struct data_fifo *, void **, size_t);
DECLARE_FAKE_VALUE_FUNC(int, data_fifo_pointer_last_filled_get, struct data_fifo *, void **,
			size_t *, k_timeout_t);
DECLARE_FAKE_VOID_FUNC2(data_fifo_block_free, struct data_fifo *, void *);
DECLARE_FAKE_VALUE_FUNC(int, data_fifo_num_used_get, struct data_fifo *, uint32_t *, uint32_t *);
DECLARE_FAKE_VALUE_FUNC(int, data_fifo_empty, struct data_fifo *);
DECLARE_FAKE_VALUE_FUNC(int, data_fifo_deinit, struct data_fifo *);
DECLARE_FAKE_VALUE_FUNC(int, data_fifo_init, struct data_fifo *);

/* List of fakes used by this unit tester */
#define DO_FOREACH_FAKE(FUNC)                                                                      \
	do {                                                                                       \
		FUNC(data_fifo_pointer_first_vacant_get)                                           \
		FUNC(data_fifo_block_lock)                                                         \
		FUNC(data_fifo_pointer_last_filled_get)                                            \
		FUNC(data_fifo_block_free)                                                         \
		FUNC(data_fifo_num_used_get)                                                       \
		FUNC(data_fifo_empty)                                                              \
		FUNC(data_fifo_deinit)                                                             \
		FUNC(data_fifo_init)                                                               \
	} while (0)

void reset_fake_fifo_counter(void);

int fake_data_fifo_pointer_first_vacant_get__succeeds(struct data_fifo *data_fifo, void **data,
						      k_timeout_t timeout);
int fake_data_fifo_pointer_first_vacant_get__timeout_fails(struct data_fifo *data_fifo, void **data,
							   k_timeout_t timeout);
int fake_data_fifo_pointer_first_vacant_get__no_wait_fails(struct data_fifo *data_fifo, void **data,
							   k_timeout_t timeout);
int fake_data_fifo_pointer_first_vacant_get__invalid_fails(struct data_fifo *data_fifo, void **data,
							   k_timeout_t timeout);
int fake_data_fifo_block_lock__succeeds(struct data_fifo *data_fifo, void **data, size_t size);
int fake_data_fifo_block_lock__size_fails(struct data_fifo *data_fifo, void **data, size_t size);
int fake_data_fifo_block_lock__size_0_fails(struct data_fifo *data_fifo, void **data, size_t size);
int fake_data_fifo_block_lock__put_fails(struct data_fifo *data_fifo, void **data, size_t size);
int fake_data_fifo_pointer_last_filled_get__succeeds(struct data_fifo *data_fifo, void **data,
						     size_t *size, k_timeout_t timeout);
int fake_data_fifo_pointer_last_filled_get__no_wait_fails(struct data_fifo *data_fifo, void **data,
							  size_t *size, k_timeout_t timeout);
int fake_data_fifo_pointer_last_filled_get__timeout_fails(struct data_fifo *data_fifo, void **data,
							  size_t *size, k_timeout_t timeout);
void fake_data_fifo_block_free__succeeds(struct data_fifo *data_fifo, void *data);
int fake_data_fifo_num_used_get__succeeds(struct data_fifo *data_fifo, uint32_t *alloced_num,
					  uint32_t *locked_num);
int fake_data_fifo_num_used_get__fails(struct data_fifo *data_fifo, uint32_t *alloced_num,
				       uint32_t *locked_num);
int fake_data_fifo_empty__succeeds(struct data_fifo *data_fifo);
int fake_data_fifo_empty__count_fails(struct data_fifo *data_fifo);
int fake_data_fifo_empty__no_wait_fails(struct data_fifo *data_fifo);
int fake_data_fifo_empty__slab_init_fails(struct data_fifo *data_fifo);
int fake_data_fifo_empty__timeout_fails(struct data_fifo *data_fifo);
int fake_data_fifo_deinit__succeeds(struct data_fifo *data_fifo);
int fake_data_fifo_deinit__fails(struct data_fifo *data_fifo);
int fake_data_fifo_init__succeeds(struct data_fifo *data_fifo);
int fake_data_fifo_init__fails(struct data_fifo *data_fifo);

#endif /* _FAKES_H_ */
```
