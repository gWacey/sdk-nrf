## CMakeLists.txt
```
#
# Copyright (c) 20234 Nordic Semiconductor ASA
#
# SPDX-License-Identifier: LicenseRef-Nordic-5-Clause
#

cmake_minimum_required(VERSION 3.20.0)

find_package(Zephyr REQUIRED HINTS $ENV{ZEPHYR_BASE})
project("Audio module Template")

target_sources(app PRIVATE
	src/main.c
	src/template_test.c
)

target_include_directories(app PRIVATE ${ZEPHYR_NRF_MODULE_DIR}/subsys/audio_modules/audio_module_template)
```

## prj.conf
```kconfig
#
# Copyright (c) 2023 Nordic Semiconductor ASA
#
# SPDX-License-Identifier: LicenseRef-Nordic-5-Clause
#

CONFIG_ZTEST=y
CONFIG_ZTEST_NEW_API=y
CONFIG_ZTEST_STACK_SIZE=8196
CONFIG_LOG=y
CONFIG_IRQ_OFFLOAD=y
CONFIG_AUDIO_MODULE_TEST=y
CONFIG_AUDIO_MODULE=y
CONFIG_AUDIO_MODULE_TEMPLATE=y

# The large stack size can be optimized
CONFIG_MAIN_STACK_SIZE=16000

CONFIG_STACK_SENTINEL=y
```

## src/main.c
```c
/*
 * Copyright (c) 2023 Nordic Semiconductor ASA
 *
 * SPDX-License-Identifier: LicenseRef-Nordic-5-Clause
 */

#include <zephyr/fff.h>
#include <zephyr/ztest.h>
#include <errno.h>
#include "fakes.h"

/* This function runs before each test */
static void run_before(void *fixture)
{
	ARG_UNUSED(fixture);

	/* Register resets */
	DO_FOREACH_FAKE(RESET_FAKE);

	/* Reset common FFF internal structures */
	FFF_RESET_HISTORY();
}

ZTEST_SUITE(suite_audio_module_template_test, NULL, NULL, run_before, NULL, NULL);
```

## src/audio_module_template_common.h
```c
/*
 * Copyright (c) 2023 Nordic Semiconductor ASA
 *
 * SPDX-License-Identifier: LicenseRef-Nordic-5-Clause
 */

#ifndef _COMMON_AUDIO_MODULE_TEST_H_
#define _COMMON_AUDIO_MODULE_TEST_H_

#include "audio_module.h"

#define FAKE_FIFO_QUEUE_SIZE	      (4)
#define FAKE_FIFO_MSG_QUEUE_SIZE      (FAKE_FIFO_QUEUE_SIZE + 1)
#define FAKE_FIFO_MSG_QUEUE_DATA_SIZE (sizeof(struct audio_module_message))
#define FAKE_FIFO_NUM		      (4)

#define TEST_MOD_THREAD_STACK_SIZE (2048)
#define TEST_MOD_THREAD_PRIORITY   (4)
#define TEST_MODULES_NUM	   (4)
#define TEST_CONNECTIONS_NUM	   (TEST_MODULES_NUM)
#define TEST_MOD_DATA_SIZE	   (40)
#define TEST_AUDIO_DATA_ITEMS_NUM  (20)

struct mod_config {
	int test_int1;
	int test_int2;
	int test_int3;
	int test_int4;
};

struct mod_context {
	const char *test_string;
	uint32_t test_uint32;

	struct mod_config config;
};

#endif /* _COMMON_AUDIO_MODULE_TEST_H_ */
```

## src/audio_module_template_test.c
```c
/*
 * Copyright (c) 2023 Nordic Semiconductor ASA
 *
 * SPDX-License-Identifier: LicenseRef-Nordic-5-Clause
 */

#include <zephyr/fff.h>
#include <zephyr/ztest.h>
#include <errno.h>

#include "fakes.h"
#include "audio_module.h"
#include "audio_module_template.h"
#include "audio_module_template_common.h"

/* Define a timeout to prevent system locking */
#define TEST_TX_RX_TIMEOUT_US (K_FOREVER)

#define CONFIG_TEXT   "Template config"
#define RECONFIG_TEXT "Template reconfig"

extern void data_fifo_deinit(struct data_fifo *data_fifo);

static const char *test_instance_name = "Test instance";
static struct audio_metadata test_metadata = {.data_coding = LC3,
					      .data_len_us = 10000,
					      .sample_rate_hz = 48000,
					      .bits_per_sample = 16,
					      .carried_bits_pr_sample = 16,
					      .locations = 0x00000003,
					      .reference_ts_us = 0,
					      .data_rx_ts_us = 0,
					      .bad_data = false};

K_THREAD_STACK_ARRAY_DEFINE(mod_stack, TEST_MODULES_NUM, TEST_MOD_THREAD_STACK_SIZE);
K_MEM_SLAB_DEFINE(mod_data_slab, TEST_MOD_DATA_SIZE, FAKE_FIFO_MSG_QUEUE_SIZE, 4);

static struct audio_module_handle handle[TEST_MODULES_NUM];

static struct data_fifo msg_fifo_rx[TEST_MODULES_NUM];
static struct data_fifo msg_fifo_tx[TEST_MODULES_NUM];

static struct audio_data audio_data_tx;
static struct audio_data audio_data_rx;

static struct audio_module_parameters mod_parameters;

static struct audio_module_template_configuration configuration = {
	.rate = 48000, .depth = 12345, .some_text = CONFIG_TEXT};
static struct audio_module_template_configuration reconfiguration = {
	.rate = 16000, .depth = 54321, .some_text = RECONFIG_TEXT};
static struct audio_module_template_configuration return_configuration;

static struct audio_module_template_context context = {0};

static uint8_t test_data_in[TEST_MOD_DATA_SIZE * TEST_AUDIO_DATA_ITEMS_NUM];
static uint8_t test_data_out[TEST_MOD_DATA_SIZE * TEST_AUDIO_DATA_ITEMS_NUM];

ZTEST(suite_audio_module_template_test, test_module_template)
{
	int ret;
	int i;
	char *base_name, instance_name[CONFIG_AUDIO_MODULE_NAME_SIZE];

	/* Fake internal empty data FIFO success */
	data_fifo_init_fake.custom_fake = fake_data_fifo_init__succeeds;
	data_fifo_pointer_first_vacant_get_fake.custom_fake =
		fake_data_fifo_pointer_first_vacant_get__succeeds;
	data_fifo_block_lock_fake.custom_fake = fake_data_fifo_block_lock__succeeds;
	data_fifo_pointer_last_filled_get_fake.custom_fake =
		fake_data_fifo_pointer_last_filled_get__succeeds;
	data_fifo_block_free_fake.custom_fake = fake_data_fifo_block_free__succeeds;

	data_fifo_deinit(&msg_fifo_rx[0]);
	data_fifo_deinit(&msg_fifo_tx[0]);

	data_fifo_init(&msg_fifo_rx[0]);
	data_fifo_init(&msg_fifo_tx[0]);

	mod_parameters.description = audio_module_template_description;
	mod_parameters.thread.stack = mod_stack[0];
	mod_parameters.thread.stack_size = TEST_MOD_THREAD_STACK_SIZE;
	mod_parameters.thread.priority = TEST_MOD_THREAD_PRIORITY;
	mod_parameters.thread.data_slab = &mod_data_slab;
	mod_parameters.thread.data_size = TEST_MOD_DATA_SIZE;
	mod_parameters.thread.msg_rx = &msg_fifo_rx[0];
	mod_parameters.thread.msg_tx = &msg_fifo_tx[0];

	ret = audio_module_open(
		&mod_parameters, (struct audio_module_configuration const *const)&configuration,
		test_instance_name, (struct audio_module_context *)&context, &handle[0]);
	zassert_equal(ret, 0, "Open function did not return successfully (0): ret %d", ret);

	{
		struct audio_module_template_context *ctx =
			(struct audio_module_template_context *)handle[0].context;
		struct audio_module_template_configuration *test_config = &ctx->config;

		zassert_equal(test_config->depth, configuration.depth,
			      "Failed to configure module in the open function");
		zassert_equal(test_config->rate, configuration.rate,
			      "Failed to configure module in the open function");
		zassert_mem_equal(test_config->some_text, configuration.some_text,
				  sizeof(CONFIG_TEXT),
				  "Failed to configure module in the open function");
	}

	zassert_equal_ptr(handle[0].description->name, audio_module_template_description->name,
			  "Failed open for names, base name should be %s, but is %s",
			  audio_module_template_description->name, handle[0].description->name);
	zassert_mem_equal(&handle[0].name[0], test_instance_name, sizeof(test_instance_name),
			  "Failed open for names, instance name should be %s, but is %s",
			  test_instance_name, handle[0].name);
	zassert_equal(handle[0].state, AUDIO_MODULE_STATE_CONFIGURED,
		      "Not in configured state after call to open the audio module");

	ret = audio_module_names_get(&handle[0], &base_name, &instance_name[0]);
	zassert_equal(ret, 0, "Get names function did not return successfully (0): ret %d", ret);
	zassert_mem_equal(base_name, audio_module_template_description->name,
			  sizeof(audio_module_template_description->name),
			  "Failed get names, base name should be %s, but is %s",
			  audio_module_template_description->name, base_name);
	zassert_mem_equal(&instance_name[0], test_instance_name, sizeof(test_instance_name),
			  "Failed get names, instance name should be %s, but is %s", handle[0].name,
			  &instance_name[0]);

	ret = audio_module_configuration_get(
		&handle[0], (struct audio_module_configuration *)&return_configuration);
	zassert_equal(ret, 0, "Configuration get function did not return successfully (0): ret %d",
		      ret);
	zassert_equal(return_configuration.depth, configuration.depth,
		      "Failed to get configuration");
	zassert_equal(return_configuration.rate, configuration.rate, "Failed to get configuration");
	zassert_mem_equal(return_configuration.some_text, configuration.some_text,
			  sizeof(CONFIG_TEXT), "Failed to get configuration");

	ret = audio_module_connect(&handle[0], NULL, true);
	zassert_equal(ret, 0, "Connect function did not return successfully (0): ret %d", ret);
	zassert_equal(handle[0].use_tx_queue, 1, "Connect queue size is not %d, but is %d", 1,
		      handle[0].use_tx_queue);

	ret = audio_module_start(&handle[0]);
	zassert_equal(ret, 0, "Start function did not return successfully (0): ret %d", ret);
	zassert_equal(handle[0].state, AUDIO_MODULE_STATE_RUNNING,
		      "Not in running state after call to start the audio module");

	for (i = 0; i < TEST_AUDIO_DATA_ITEMS_NUM; i++) {
		printk("Process audio buffer %d\n", i);

		audio_data_tx.data = (void *)&test_data_in[i * TEST_MOD_DATA_SIZE];
		audio_data_tx.data_size = TEST_MOD_DATA_SIZE;
		memcpy(&audio_data_tx.meta, &test_metadata, sizeof(struct audio_metadata));

		audio_data_rx.data = (void *)&test_data_out[i * TEST_MOD_DATA_SIZE];
		audio_data_rx.data_size = TEST_MOD_DATA_SIZE;

		ret = audio_module_data_tx_rx(&handle[0], &handle[0], &audio_data_tx,
					      &audio_data_rx, TEST_TX_RX_TIMEOUT_US);
		zassert_equal(ret, 0, "Data TX-RX function did not return successfully (0): ret %d",
			      ret);
		zassert_mem_equal(audio_data_tx.data, audio_data_rx.data, TEST_MOD_DATA_SIZE,
				  "Failed to process data");
		zassert_equal(audio_data_tx.data_size, audio_data_rx.data_size,
			      "Failed to process data, sizes differ");
		zassert_mem_equal(&audio_data_tx.meta, &audio_data_rx.meta,
				  sizeof(struct audio_metadata),
				  "Failed to process data, meta data differs");

		if (i == TEST_AUDIO_DATA_ITEMS_NUM / 2) {
			ret = audio_module_stop(&handle[0]);
			zassert_equal(ret, 0,
				      "Stop function did not return successfully (0): ret %d", ret);

			ret = audio_module_reconfigure(
				&handle[0],
				(const struct audio_module_configuration *const)&reconfiguration);
			zassert_equal(
				ret, 0,
				"Reconfigure function did not return successfully (0): ret %d",
				ret);
			zassert_equal(reconfiguration.depth, reconfiguration.depth,
				      "Failed to reconfigure module");
			zassert_equal(reconfiguration.rate, reconfiguration.rate,
				      "Failed to reconfigure module");
			zassert_mem_equal(reconfiguration.some_text, reconfiguration.some_text,
					  sizeof(RECONFIG_TEXT), "Failed to reconfigure module");

			ret = audio_module_start(&handle[0]);
			zassert_equal(ret, 0,
				      "Start function did not return successfully (0): ret %d",
				      ret);
			zassert_equal(handle[0].state, AUDIO_MODULE_STATE_RUNNING,
				      "Not in running state after call to start the audio module");
		}
	}

	ret = audio_module_disconnect(&handle[0], NULL, true);
	zassert_equal(ret, 0, "Disconnect function did not return successfully (0): ret %d", ret);
	zassert_equal(handle[0].use_tx_queue, 0, "Disconnect queue size is not %d, but is %d", 0,
		      handle[0].use_tx_queue);

	ret = audio_module_stop(&handle[0]);
	zassert_equal(ret, 0, "Stop function did not return successfully (0): ret %d", ret);
	zassert_equal(handle[0].state, AUDIO_MODULE_STATE_STOPPED,
		      "Not in stopped state after call to stop the audio module");

	ret = audio_module_close(&handle[0]);
	zassert_equal(ret, 0, "Close function did not return successfully (0): ret %d", ret);
}

ZTEST(suite_audio_module_template_test, test_module_template_stream)
{
	int ret;
	int i;
	char inst_name[CONFIG_AUDIO_MODULE_NAME_SIZE];

	/* Fake internal empty data FIFO success */
	data_fifo_init_fake.custom_fake = fake_data_fifo_init__succeeds;
	data_fifo_pointer_first_vacant_get_fake.custom_fake =
		fake_data_fifo_pointer_first_vacant_get__succeeds;
	data_fifo_block_lock_fake.custom_fake = fake_data_fifo_block_lock__succeeds;
	data_fifo_pointer_last_filled_get_fake.custom_fake =
		fake_data_fifo_pointer_last_filled_get__succeeds;
	data_fifo_block_free_fake.custom_fake = fake_data_fifo_block_free__succeeds;

	for (i = 0; i < TEST_MODULES_NUM; i++) {

		memset(&handle[i], 0, sizeof(struct audio_module_handle));

		data_fifo_deinit(&msg_fifo_rx[i]);
		data_fifo_deinit(&msg_fifo_tx[i]);

		data_fifo_init(&msg_fifo_rx[i]);
		data_fifo_init(&msg_fifo_tx[i]);

		mod_parameters.description = audio_module_template_description;
		mod_parameters.thread.stack = mod_stack[i];
		mod_parameters.thread.stack_size = TEST_MOD_THREAD_STACK_SIZE;
		mod_parameters.thread.priority = TEST_MOD_THREAD_PRIORITY;
		mod_parameters.thread.data_slab = &mod_data_slab;
		mod_parameters.thread.data_size = TEST_MOD_DATA_SIZE;
		mod_parameters.thread.msg_rx = &msg_fifo_rx[i];
		mod_parameters.thread.msg_tx = &msg_fifo_tx[i];

		sprintf(&inst_name[0], "Stream module %d", i);

		ret = audio_module_open(
			&mod_parameters,
			(const struct audio_module_configuration *const)&configuration,
			&inst_name[0], (struct audio_module_context *)&context, &handle[i]);
		zassert_equal(ret, 0, "Open function did not return successfully (0): ret %d", ret);
	}

	for (i = 1; i < TEST_MODULES_NUM; i++) {
		ret = audio_module_connect(&handle[i - 1], &handle[i], false);
		zassert_equal(ret, 0, "Connect function did not return successfully (0): ret %d",
			      ret);

		ret = audio_module_start(&handle[i - 1]);
		zassert_equal(ret, 0, "Start function did not return successfully (0): ret %d",
			      ret);
	}

	ret = audio_module_connect(&handle[TEST_MODULES_NUM - 1], NULL, true);
	zassert_equal(ret, 0, "Connect function did not return successfully (0): ret %d", ret);

	ret = audio_module_start(&handle[TEST_MODULES_NUM - 1]);
	zassert_equal(ret, 0, "Start function did not return successfully (0): ret %d", ret);

	for (i = 0; i < TEST_AUDIO_DATA_ITEMS_NUM; i++) {
		printk("Process audio buffer %d\n", i);

		audio_data_tx.data = (void *)&test_data_in[i * TEST_MOD_DATA_SIZE];
		audio_data_tx.data_size = TEST_MOD_DATA_SIZE;
		memcpy(&audio_data_tx.meta, &test_metadata, sizeof(struct audio_metadata));

		audio_data_rx.data = (void *)&test_data_out[i * TEST_MOD_DATA_SIZE];
		audio_data_tx.data_size = TEST_MOD_DATA_SIZE;

		ret = audio_module_data_tx_rx(&handle[0], &handle[TEST_MODULES_NUM - 1],
					      &audio_data_tx, &audio_data_rx,
					      TEST_TX_RX_TIMEOUT_US);
		zassert_equal(ret, 0, "Data TX-RX function did not return successfully (0): ret %d",
			      ret);
		zassert_mem_equal(audio_data_tx.data, audio_data_rx.data, TEST_MOD_DATA_SIZE,
				  "Failed to process data");
		zassert_equal(audio_data_tx.data_size, audio_data_rx.data_size,
			      "Failed to process data, sizes differ");
		zassert_mem_equal(&audio_data_tx.meta, &audio_data_rx.meta,
				  sizeof(struct audio_metadata),
				  "Failed to process data, meta data differs");
	}

	ret = audio_module_stop(&handle[0]);
	zassert_equal(ret, 0, "Stop function did not return successfully (0): ret %d", ret);

	ret = audio_module_close(&handle[0]);
	zassert_equal(ret, 0, "Close function did not return successfully (0): ret %d", ret);
}
```

## src/fakes.c
```c
/*
 * Copyright (c) 2023 Nordic Semiconductor ASA
 *
 * SPDX-License-Identifier: LicenseRef-Nordic-5-Clause
 */

#include <zephyr/ztest.h>
#include <zephyr/fff.h>

#include "audio_module_template_common.h"
#include "data_fifo.h"
#include "fakes.h"

/* Overload the message buffer pointer with a point to one of the an arrays below */
static int fifo_num;

struct test_slab_queue {
	size_t head;
	size_t tail;
	size_t size;
	size_t locked;

	void **data[FAKE_FIFO_MSG_QUEUE_SIZE];
	struct audio_module_message msg[FAKE_FIFO_MSG_QUEUE_SIZE];
};

struct test_msg_fifo_queue {
	size_t head;
	size_t tail;
	size_t size;
	size_t locked;

	void **data[FAKE_FIFO_MSG_QUEUE_SIZE];
};

/* FIFO "slab" */
static struct test_slab_queue test_fifo_slab[FAKE_FIFO_NUM];

/* FIFO "message" queue */
static struct test_msg_fifo_queue test_fifo_msg_queue[FAKE_FIFO_NUM];

void data_fifo_deinit(struct data_fifo *data_fifo)
{
	data_fifo->msgq_buffer = (char *)NULL;
	data_fifo->slab_buffer = (char *)NULL;
	data_fifo->elements_max = 0;
	data_fifo->block_size_max = 0;
	data_fifo->initialized = false;

	fifo_num = 0;
}

/*
 * Stubs are defined here, so that multiple *.c files can share them
 * without having linker issues.
 */
DEFINE_FFF_GLOBALS;

DEFINE_FAKE_VALUE_FUNC(int, data_fifo_pointer_first_vacant_get, struct data_fifo *, void **,
		       k_timeout_t);
DEFINE_FAKE_VALUE_FUNC(int, data_fifo_block_lock, struct data_fifo *, void **, size_t);
DEFINE_FAKE_VALUE_FUNC(int, data_fifo_pointer_last_filled_get, struct data_fifo *, void **,
		       size_t *, k_timeout_t);
DEFINE_FAKE_VOID_FUNC2(data_fifo_block_free, struct data_fifo *, void **);
DEFINE_FAKE_VALUE_FUNC(int, data_fifo_num_used_get, struct data_fifo *, uint32_t *, uint32_t *);
DEFINE_FAKE_VALUE_FUNC(int, data_fifo_empty, struct data_fifo *);
DEFINE_FAKE_VALUE_FUNC(int, data_fifo_init, struct data_fifo *);

/* Custom fakes implementation */
int fake_data_fifo_pointer_first_vacant_get__succeeds(struct data_fifo *data_fifo, void **data,
						      k_timeout_t timeout)
{
	struct test_slab_queue *test_fifo_slab_data =
		(struct test_slab_queue *)data_fifo->slab_buffer;

	if (test_fifo_slab_data->head == test_fifo_slab_data->tail) {
		return -EINVAL;
	}

	*data = &test_fifo_slab_data->msg[test_fifo_slab_data->tail % test_fifo_slab_data->size];
	test_fifo_slab_data->tail = (test_fifo_slab_data->tail + 1) % test_fifo_slab_data->size;

	return 0;
}

int fake_data_fifo_pointer_first_vacant_get__timeout_fails(struct data_fifo *data_fifo, void **data,
							   k_timeout_t timeout)
{
	ARG_UNUSED(data_fifo);
	ARG_UNUSED(data);
	ARG_UNUSED(timeout);

	return -ENOMSG;
}

int fake_data_fifo_pointer_first_vacant_get__no_wait_fails(struct data_fifo *data_fifo, void **data,
							   k_timeout_t timeout)
{
	ARG_UNUSED(data_fifo);
	ARG_UNUSED(data);
	ARG_UNUSED(timeout);

	return -EAGAIN;
}

int fake_data_fifo_pointer_first_vacant_get__invalid_fails(struct data_fifo *data_fifo, void **data,
							   k_timeout_t timeout)
{
	ARG_UNUSED(data_fifo);
	ARG_UNUSED(data);
	ARG_UNUSED(timeout);

	return -EINVAL;
}

int fake_data_fifo_block_lock__succeeds(struct data_fifo *data_fifo, void **data, size_t size)
{
	ARG_UNUSED(size);
	struct test_msg_fifo_queue *test_fifo_msg =
		(struct test_msg_fifo_queue *)data_fifo->msgq_buffer;

	if (((test_fifo_msg->head + 1) % test_fifo_msg->size) == test_fifo_msg->tail) {
		return -EINVAL;
	}

	test_fifo_msg->data[test_fifo_msg->head] = *data;
	test_fifo_msg->head = (test_fifo_msg->head + 1) % test_fifo_msg->size;

	test_fifo_msg->locked++;

	return 0;
}

int fake_data_fifo_block_lock__size_fails(struct data_fifo *data_fifo, void **data, size_t size)
{
	ARG_UNUSED(data_fifo);
	ARG_UNUSED(data);
	ARG_UNUSED(size);

	return -ENOMEM;
}

int fake_data_fifo_block_lock__size_0_fails(struct data_fifo *data_fifo, void **data, size_t size)
{
	ARG_UNUSED(data_fifo);
	ARG_UNUSED(data);
	ARG_UNUSED(size);

	return -EINVAL;
}

int fake_data_fifo_block_lock__put_fails(struct data_fifo *data_fifo, void **data, size_t size)
{
	ARG_UNUSED(data_fifo);
	ARG_UNUSED(data);
	ARG_UNUSED(size);

	return -ESPIPE;
}

int fake_data_fifo_pointer_last_filled_get__succeeds(struct data_fifo *data_fifo, void **data,
						     size_t *size, k_timeout_t timeout)
{
	struct audio_module_message *msg;
	struct test_msg_fifo_queue *test_fifo_msg =
		(struct test_msg_fifo_queue *)data_fifo->msgq_buffer;

	if (test_fifo_msg->tail == test_fifo_msg->head) {
		return -EINVAL;
	}

	msg = (struct audio_module_message *)test_fifo_msg->data[test_fifo_msg->tail];

	test_fifo_msg->data[test_fifo_msg->tail] = NULL;
	test_fifo_msg->tail = (test_fifo_msg->tail + 1) % test_fifo_msg->size;

	*data = msg;
	*size = sizeof(struct audio_module_message);

	test_fifo_msg->locked--;

	return 0;
}

int fake_data_fifo_pointer_last_filled_get__no_wait_fails(struct data_fifo *data_fifo, void **data,
							  size_t *size, k_timeout_t timeout)
{
	ARG_UNUSED(data_fifo);
	ARG_UNUSED(data);
	ARG_UNUSED(size);
	ARG_UNUSED(timeout);

	return -ENOMSG;
}

int fake_data_fifo_pointer_last_filled_get__timeout_fails(struct data_fifo *data_fifo, void **data,
							  size_t *size, k_timeout_t timeout)
{
	ARG_UNUSED(data_fifo);
	ARG_UNUSED(data);
	ARG_UNUSED(size);
	ARG_UNUSED(timeout);

	return -EAGAIN;
}

void fake_data_fifo_block_free__succeeds(struct data_fifo *data_fifo, void **data)
{
	ARG_UNUSED(data);

	struct test_slab_queue *test_fifo_slab_data =
		(struct test_slab_queue *)data_fifo->slab_buffer;

	if (test_fifo_slab_data->tail == test_fifo_slab_data->head) {
		return;
	}

	test_fifo_slab_data->head = (test_fifo_slab_data->head + 1) % test_fifo_slab_data->size;
}

int fake_data_fifo_num_used_get__succeeds(struct data_fifo *data_fifo, uint32_t *alloced_num,
					  uint32_t *locked_num)
{
	struct test_msg_fifo_queue *test_fifo_msg =
		(struct test_msg_fifo_queue *)data_fifo->msgq_buffer;

	*alloced_num = test_fifo_msg->head - test_fifo_msg->tail;
	*locked_num = test_fifo_msg->locked;

	return 0;
}

int fake_data_fifo_num_used_get__fails(struct data_fifo *data_fifo, uint32_t *alloced_num,
				       uint32_t *locked_num)
{
	ARG_UNUSED(data_fifo);
	ARG_UNUSED(alloced_num);
	ARG_UNUSED(locked_num);

	return -EACCES;
}

int fake_data_fifo_empty__succeeds(struct data_fifo *data_fifo)
{
	struct test_msg_fifo_queue *test_fifo_msg =
		(struct test_msg_fifo_queue *)data_fifo->msgq_buffer;
	struct test_slab_queue *test_fifo_slab_data =
		(struct test_slab_queue *)data_fifo->slab_buffer;

	test_fifo_msg->head = 0;
	test_fifo_msg->tail = 0;
	test_fifo_msg->size = FAKE_FIFO_MSG_QUEUE_SIZE;
	test_fifo_msg->locked = 0;

	test_fifo_slab_data->head = 0;
	test_fifo_slab_data->tail = 0;
	test_fifo_slab_data->size = FAKE_FIFO_MSG_QUEUE_SIZE;

	return 0;
}

int fake_data_fifo_empty__count_fails(struct data_fifo *data_fifo)
{
	ARG_UNUSED(data_fifo);

	return -EACCES;
}

int fake_data_fifo_empty__no_wait_fails(struct data_fifo *data_fifo)
{
	ARG_UNUSED(data_fifo);

	return -ENOMSG;
}

int fake_data_fifo_empty__slab_init_fails(struct data_fifo *data_fifo)
{
	ARG_UNUSED(data_fifo);

	return -EINVAL;
}

int fake_data_fifo_empty__timeout_fails(struct data_fifo *data_fifo)
{
	ARG_UNUSED(data_fifo);

	return -EAGAIN;
}

int fake_data_fifo_init__succeeds(struct data_fifo *data_fifo)
{
	struct test_msg_fifo_queue *test_fifo_msg = &test_fifo_msg_queue[fifo_num];
	struct test_slab_queue *test_fifo_slab_data = &test_fifo_slab[fifo_num];

	data_fifo->msgq_buffer = (char *)test_fifo_msg;
	data_fifo->slab_buffer = (char *)test_fifo_slab_data;
	data_fifo->elements_max = FAKE_FIFO_MSG_QUEUE_SIZE;
	data_fifo->block_size_max = TEST_MOD_DATA_SIZE;
	data_fifo->initialized = true;

	fifo_num += 1;

	test_fifo_msg->head = 0;
	test_fifo_msg->tail = 0;
	test_fifo_msg->size = FAKE_FIFO_MSG_QUEUE_SIZE;
	test_fifo_msg->locked = 0;

	test_fifo_slab_data->head = 0;
	test_fifo_slab_data->tail = 0;
	test_fifo_slab_data->size = FAKE_FIFO_MSG_QUEUE_SIZE;

	for (int i = 0; i < FAKE_FIFO_MSG_QUEUE_SIZE - 1; i++) {
		if (((test_fifo_slab_data->head + 1) % test_fifo_slab_data->size) ==
		    test_fifo_slab_data->tail) {
			return -ENOMSG;
		}
		test_fifo_slab_data->data[test_fifo_slab_data->head] =
			(void **)&test_fifo_slab_data->msg[i];
		test_fifo_slab_data->head =
			(test_fifo_slab_data->head + 1) % test_fifo_slab_data->size;
	}

	return 0;
}

int fake_data_fifo_init__fails(struct data_fifo *data_fifo)
{
	ARG_UNUSED(data_fifo);

	return -EINVAL;
}
```

## src/template_test.c
```c
/*
 * Copyright (c) 2024 Nordic Semiconductor ASA
 *
 * SPDX-License-Identifier: LicenseRef-Nordic-5-Clause
 */

#include <zephyr/fff.h>
#include <zephyr/ztest.h>
#include <errno.h>

#include "audio_module.h"
#include "audio_module_template.h"

/* Define a timeout to prevent system locking */
#define TEST_TX_RX_TIMEOUT_US (K_FOREVER)

#define CONFIG_TEXT   "Template config"
#define RECONFIG_TEXT "Template reconfig"

#define TEST_MSG_QUEUE_SIZE	   (4)
#define TEST_MOD_THREAD_STACK_SIZE (2048)
#define TEST_MOD_THREAD_PRIORITY   (4)
#define TEST_CONNECTIONS_NUM	   (5)
#define TEST_MODULES_NUM	   (TEST_CONNECTIONS_NUM - 1)
#define TEST_MOD_DATA_SIZE	   (40)
#define TEST_MSG_SIZE		   (sizeof(struct audio_module_message))
#define TEST_AUDIO_DATA_ITEMS_NUM  (20)

struct mod_config {
	int test_int1;
	int test_int2;
	int test_int3;
	int test_int4;
};

struct mod_context {
	const char *test_string;
	uint32_t test_uint32;

	struct mod_config config;
};

const char *test_instance_name = "Test instance";
struct audio_metadata test_metadata = {.data_coding = LC3,
				       .data_len_us = 10000,
				       .sample_rate_hz = 48000,
				       .bits_per_sample = 16,
				       .carried_bits_per_sample = 16,
				       .locations = 0x00000003,
				       .reference_ts_us = 0,
				       .data_rx_ts_us = 0,
				       .bad_data = false};

K_THREAD_STACK_ARRAY_DEFINE(mod_temp_stack, TEST_MODULES_NUM, TEST_MOD_THREAD_STACK_SIZE);
DATA_FIFO_DEFINE(msg_fifo_tx, TEST_MSG_QUEUE_SIZE, TEST_MSG_SIZE);
DATA_FIFO_DEFINE(msg_fifo_rx, TEST_MSG_QUEUE_SIZE, TEST_MSG_SIZE);
DATA_FIFO_DEFINE(msg_fifo_tx1, TEST_MSG_QUEUE_SIZE, TEST_MSG_SIZE);
DATA_FIFO_DEFINE(msg_fifo_rx1, TEST_MSG_QUEUE_SIZE, TEST_MSG_SIZE);
DATA_FIFO_DEFINE(msg_fifo_tx2, TEST_MSG_QUEUE_SIZE, TEST_MSG_SIZE);
DATA_FIFO_DEFINE(msg_fifo_rx2, TEST_MSG_QUEUE_SIZE, TEST_MSG_SIZE);
DATA_FIFO_DEFINE(msg_fifo_tx3, TEST_MSG_QUEUE_SIZE, TEST_MSG_SIZE);
DATA_FIFO_DEFINE(msg_fifo_rx3, TEST_MSG_QUEUE_SIZE, TEST_MSG_SIZE);
K_MEM_SLAB_DEFINE(mod_data_slab, TEST_MOD_DATA_SIZE, TEST_MSG_QUEUE_SIZE, 4);

struct data_fifo *msg_fifo_tx_array[TEST_MODULES_NUM] = {&msg_fifo_tx, &msg_fifo_tx1, &msg_fifo_tx2,
							 &msg_fifo_tx3};
struct data_fifo *msg_fifo_rx_array[TEST_MODULES_NUM] = {&msg_fifo_rx, &msg_fifo_rx1, &msg_fifo_rx2,
							 &msg_fifo_rx3};

ZTEST(suite_audio_module_template, test_module_template)
{
	int ret;
	int i;
	char *base_name, instance_name[CONFIG_AUDIO_MODULE_NAME_SIZE];

	struct audio_data audio_data_tx;
	struct audio_data audio_data_rx;

	struct audio_module_parameters mod_parameters;

	struct audio_module_template_configuration configuration = {
		.sample_rate_hz = 48000, .bit_depth = 12345, .some_text = CONFIG_TEXT};
	struct audio_module_template_configuration reconfiguration = {
		.sample_rate_hz = 16000, .bit_depth = 54321, .some_text = RECONFIG_TEXT};
	struct audio_module_template_configuration return_configuration;

	struct audio_module_template_context context = {0};

	uint8_t test_data_in[TEST_MOD_DATA_SIZE * TEST_AUDIO_DATA_ITEMS_NUM];
	uint8_t test_data_out[TEST_MOD_DATA_SIZE * TEST_AUDIO_DATA_ITEMS_NUM];

	struct audio_module_handle handle;

	mod_parameters.description = audio_module_template_description;
	mod_parameters.thread.stack = mod_temp_stack[0];
	mod_parameters.thread.stack_size = TEST_MOD_THREAD_STACK_SIZE;
	mod_parameters.thread.priority = TEST_MOD_THREAD_PRIORITY;
	mod_parameters.thread.data_slab = &mod_data_slab;
	mod_parameters.thread.data_size = TEST_MOD_DATA_SIZE;
	mod_parameters.thread.msg_rx = &msg_fifo_rx;
	mod_parameters.thread.msg_tx = &msg_fifo_tx;

	ret = audio_module_open(
		&mod_parameters, (struct audio_module_configuration const *const)&configuration,
		test_instance_name, (struct audio_module_context *)&context, &handle);
	zassert_equal(ret, 0, "Open function did not return successfully (0): ret %d", ret);

	{
		struct audio_module_template_context *ctx =
			(struct audio_module_template_context *)handle.context;
		struct audio_module_template_configuration *test_config = &ctx->config;

		zassert_equal(test_config->bit_depth, configuration.bit_depth,
			      "Failed to configure module in the open function");
		zassert_equal(test_config->sample_rate_hz, configuration.sample_rate_hz,
			      "Failed to configure module in the open function");
		zassert_mem_equal(test_config->some_text, configuration.some_text,
				  sizeof(CONFIG_TEXT),
				  "Failed to configure module in the open function");
	}

	zassert_equal_ptr(handle.description->name, audio_module_template_description->name,
			  "Failed open for names, base name should be %s, but is %s",
			  audio_module_template_description->name, handle.description->name);
	zassert_mem_equal(&handle.name[0], test_instance_name, strlen(test_instance_name),
			  "Failed open for names, instance name should be %s, but is %s",
			  test_instance_name, handle.name);
	zassert_equal(handle.state, AUDIO_MODULE_STATE_CONFIGURED,
		      "Not in configured state after call to open the audio module");

	ret = audio_module_names_get(&handle, &base_name, &instance_name[0]);
	zassert_equal(ret, 0, "Get names function did not return successfully (0): ret %d", ret);
	zassert_mem_equal(base_name, audio_module_template_description->name,
			  strlen(audio_module_template_description->name),
			  "Failed get names, base name should be %s, but is %s",
			  audio_module_template_description->name, base_name);
	zassert_mem_equal(&instance_name[0], test_instance_name, strlen(test_instance_name),
			  "Failed get names, instance name should be %s, but is %s", handle.name,
			  &instance_name[0]);

	ret = audio_module_configuration_get(
		&handle, (struct audio_module_configuration *)&return_configuration);
	zassert_equal(ret, 0, "Configuration get function did not return successfully (0): ret %d",
		      ret);
	zassert_equal(return_configuration.bit_depth, configuration.bit_depth,
		      "Failed to get configuration");
	zassert_equal(return_configuration.sample_rate_hz, configuration.sample_rate_hz,
		      "Failed to get configuration");
	zassert_mem_equal(return_configuration.some_text, configuration.some_text,
			  sizeof(CONFIG_TEXT), "Failed to get configuration");

	ret = audio_module_connect(&handle, NULL, true);
	zassert_equal(ret, 0, "Connect function did not return successfully (0): ret %d", ret);
	zassert_equal(handle.use_tx_queue, 1, "Connect queue size is not %d, but is %d", 1,
		      handle.use_tx_queue);

	ret = audio_module_start(&handle);
	zassert_equal(ret, 0, "Start function did not return successfully (0): ret %d", ret);
	zassert_equal(handle.state, AUDIO_MODULE_STATE_RUNNING,
		      "Not in running state after call to start the audio module");

	for (i = 0; i < TEST_AUDIO_DATA_ITEMS_NUM; i++) {
		audio_data_tx.data = (void *)&test_data_in[i * TEST_MOD_DATA_SIZE];
		audio_data_tx.data_size = TEST_MOD_DATA_SIZE;
		memcpy(&audio_data_tx.meta, &test_metadata, sizeof(struct audio_metadata));

		audio_data_rx.data = (void *)&test_data_out[i * TEST_MOD_DATA_SIZE];
		audio_data_rx.data_size = TEST_MOD_DATA_SIZE;

		ret = audio_module_data_tx_rx(&handle, &handle, &audio_data_tx, &audio_data_rx,
					      TEST_TX_RX_TIMEOUT_US);
		zassert_equal(ret, 0, "Data TX-RX function did not return successfully (0): ret %d",
			      ret);
		zassert_mem_equal(audio_data_tx.data, audio_data_rx.data, TEST_MOD_DATA_SIZE,
				  "Failed to process data");
		zassert_equal(audio_data_tx.data_size, audio_data_rx.data_size,
			      "Failed to process data, sizes differ");
		zassert_mem_equal(&audio_data_tx.meta, &audio_data_rx.meta,
				  sizeof(struct audio_metadata),
				  "Failed to process data, meta data differs");

		if (i == TEST_AUDIO_DATA_ITEMS_NUM / 2) {
			ret = audio_module_stop(&handle);
			zassert_equal(ret, 0,
				      "Stop function did not return successfully (0): ret %d", ret);

			ret = audio_module_reconfigure(
				&handle,
				(const struct audio_module_configuration *const)&reconfiguration);
			zassert_equal(
				ret, 0,
				"Reconfigure function did not return successfully (0): ret %d",
				ret);
			zassert_equal(reconfiguration.bit_depth, reconfiguration.bit_depth,
				      "Failed to reconfigure module");
			zassert_equal(reconfiguration.sample_rate_hz,
				      reconfiguration.sample_rate_hz,
				      "Failed to reconfigure module");
			zassert_mem_equal(reconfiguration.some_text, reconfiguration.some_text,
					  sizeof(RECONFIG_TEXT), "Failed to reconfigure module");

			ret = audio_module_start(&handle);
			zassert_equal(ret, 0,
				      "Start function did not return successfully (0): ret %d",
				      ret);
			zassert_equal(handle.state, AUDIO_MODULE_STATE_RUNNING,
				      "Not in running state after call to start the audio module");
		}
	}

	ret = audio_module_disconnect(&handle, NULL, true);
	zassert_equal(ret, 0, "Disconnect function did not return successfully (0): ret %d", ret);
	zassert_equal(handle.use_tx_queue, 0, "Disconnect queue size is not %d, but is %d", 0,
		      handle.use_tx_queue);

	ret = audio_module_stop(&handle);
	zassert_equal(ret, 0, "Stop function did not return successfully (0): ret %d", ret);
	zassert_equal(handle.state, AUDIO_MODULE_STATE_STOPPED,
		      "Not in stopped state after call to stop the audio module");

	ret = audio_module_close(&handle);
	zassert_equal(ret, 0, "Close function did not return successfully (0): ret %d", ret);
}

ZTEST(suite_audio_module_template, test_module_template_stream)
{
	int ret;
	int i;
	char inst_name[CONFIG_AUDIO_MODULE_NAME_SIZE];

	struct audio_data audio_data_tx;
	struct audio_data audio_data_rx;

	struct audio_module_parameters mod_parameters;

	struct audio_module_template_configuration configuration = {
		.sample_rate_hz = 48000, .bit_depth = 12345, .some_text = CONFIG_TEXT};

	struct audio_module_template_context context = {0};

	uint8_t test_data_in[TEST_MOD_DATA_SIZE * TEST_AUDIO_DATA_ITEMS_NUM];
	uint8_t test_data_out[TEST_MOD_DATA_SIZE * TEST_AUDIO_DATA_ITEMS_NUM];

	struct audio_module_handle handle[TEST_MODULES_NUM];

	for (i = 0; i < TEST_MODULES_NUM; i++) {

		memset(&handle[i], 0, sizeof(struct audio_module_handle));

		mod_parameters.description = audio_module_template_description;
		mod_parameters.thread.stack = mod_temp_stack[i];
		mod_parameters.thread.stack_size = TEST_MOD_THREAD_STACK_SIZE;
		mod_parameters.thread.priority = TEST_MOD_THREAD_PRIORITY;
		mod_parameters.thread.data_slab = &mod_data_slab;
		mod_parameters.thread.data_size = TEST_MOD_DATA_SIZE;
		mod_parameters.thread.msg_rx = msg_fifo_rx_array[i];
		mod_parameters.thread.msg_tx = msg_fifo_tx_array[i];

		ret = audio_module_open(
			&mod_parameters,
			(const struct audio_module_configuration *const)&configuration,
			&inst_name[0], (struct audio_module_context *)&context, &handle[i]);
		zassert_equal(ret, 0, "Open function did not return successfully (0): ret %d", ret);
	}

	for (i = 1; i < TEST_MODULES_NUM; i++) {
		ret = audio_module_connect(&handle[i - 1], &handle[i], false);
		zassert_equal(ret, 0, "Connect function did not return successfully (0): ret %d",
			      ret);
	}

	ret = audio_module_connect(&handle[TEST_MODULES_NUM - 1], NULL, true);
	zassert_equal(ret, 0, "Connect function did not return successfully (0): ret %d", ret);

	for (i = 0; i < TEST_MODULES_NUM; i++) {
		ret = audio_module_start(&handle[i]);
		zassert_equal(ret, 0, "Start function did not return successfully (0): ret %d",
			      ret);
	}

	for (i = 0; i < TEST_AUDIO_DATA_ITEMS_NUM; i++) {
		audio_data_tx.data = (void *)&test_data_in[i * TEST_MOD_DATA_SIZE];
		audio_data_tx.data_size = TEST_MOD_DATA_SIZE;
		memcpy(&audio_data_tx.meta, &test_metadata, sizeof(struct audio_metadata));

		audio_data_rx.data = (void *)&test_data_out[i * TEST_MOD_DATA_SIZE];
		audio_data_rx.data_size = TEST_MOD_DATA_SIZE;

		ret = audio_module_data_tx_rx(&handle[0], &handle[TEST_MODULES_NUM - 1],
					      &audio_data_tx, &audio_data_rx,
					      TEST_TX_RX_TIMEOUT_US);
		zassert_equal(ret, 0, "Data TX-RX function did not return successfully (0): ret %d",
			      ret);
		zassert_mem_equal(audio_data_tx.data, audio_data_rx.data, TEST_MOD_DATA_SIZE,
				  "Failed to process data");
		zassert_equal(audio_data_tx.data_size, audio_data_rx.data_size,
			      "Failed to process data, sizes differ");
		zassert_mem_equal(&audio_data_tx.meta, &audio_data_rx.meta,
				  sizeof(struct audio_metadata),
				  "Failed to process data, meta data differs");
	}

	for (i = 1; i < TEST_MODULES_NUM; i++) {
		ret = audio_module_stop(&handle[i]);
		zassert_equal(ret, 0, "Stop function did not return successfully (0): ret %d", ret);

		ret = audio_module_close(&handle[i]);
		zassert_equal(ret, 0, "Close function did not return successfully (0): ret %d",
			      ret);
	}
}
```
